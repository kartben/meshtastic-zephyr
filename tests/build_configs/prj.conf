## CMakeLists.txt
```
cmake_minimum_required(VERSION 3.20.0)

find_package(Zephyr REQUIRED HINTS $ENV{ZEPHYR_BASE})
project(meshtastic_build_configs)

target_sources(app PRIVATE src/main.c)
```

## prj.conf
```kconfig
CONFIG_MESHTASTIC=y
CONFIG_MESHTASTIC_NODE_ID_CUSTOM=y

CONFIG_MAIN_STACK_SIZE=4096
```

## overlay-mqtt.conf
```kconfig
CONFIG_NETWORKING=y
CONFIG_NET_IPV4=y
CONFIG_NET_UDP=y
CONFIG_NET_TCP=y
CONFIG_NET_SOCKETS=y
CONFIG_DNS_RESOLVER=y

CONFIG_MQTT_LIB=y
CONFIG_MQTT_LIB_TLS=n

CONFIG_MESHTASTIC_MQTT=y
CONFIG_MESHTASTIC_MQTT_UPLINK_ENABLED=y
CONFIG_MESHTASTIC_MQTT_DOWNLINK_ENABLED=y
```

## overlay-settings.conf
```kconfig
CONFIG_MESHTASTIC_SETTINGS=y

CONFIG_SETTINGS=y
CONFIG_FLASH=y
CONFIG_FLASH_MAP=y
CONFIG_FLASH_SIMULATOR=y
CONFIG_NVS=y
CONFIG_SETTINGS_NVS=y
```

## src/main.c
```c
/* SPDX-FileCopyrightText: Benjamin Cabé <kartben@gmail.com>
 * SPDX-License-Identifier: GPL-3.0
 */

/*
 * Build-only coverage for feature combinations the running suites do not
 * compile: the settings backend and the MQTT gateway, and the Kconfig switches
 * that turn optional behaviour off. Nothing here runs; the value is that every
 * combination keeps compiling.
 */

#include <zephyr/kernel.h>

#include <zephyr/meshtastic/meshtastic.h>

int main(void)
{
	static const struct meshtastic_config cfg = {
		.psk = meshtastic_default_psk,
		.psk_len = sizeof(meshtastic_default_psk),
		.channel_name = MESHTASTIC_CHANNEL_LONGFAST,
		.frequency = MESHTASTIC_FREQ_EU,
	};

	(void)meshtastic_init(&cfg);

	return 0;
}
```
