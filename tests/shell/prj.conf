## CMakeLists.txt
```
cmake_minimum_required(VERSION 3.20.0)

find_package(Zephyr REQUIRED HINTS $ENV{ZEPHYR_BASE})
project(meshtastic_shell_tests)

include(${CMAKE_CURRENT_SOURCE_DIR}/../common/meshtastic_test.cmake)
meshtastic_test_setup()
meshtastic_test_use_mock_lora()

target_sources(app PRIVATE
  src/commands.c
  src/shell_fixture.c
)
```

## prj.conf
```kconfig
CONFIG_ZTEST=y

CONFIG_SHELL=y
CONFIG_SHELL_BACKEND_SERIAL=n
CONFIG_SHELL_BACKEND_DUMMY=y
CONFIG_SHELL_BACKEND_DUMMY_BUF_SIZE=2048
CONFIG_SHELL_CMD_BUFF_SIZE=512
# Keep command output out of the shell's own log stream.
CONFIG_LOG=n

CONFIG_MESHTASTIC=y
CONFIG_MESHTASTIC_SHELL=y
CONFIG_MESHTASTIC_SETTINGS=n
CONFIG_MESHTASTIC_BLE=n
CONFIG_MESHTASTIC_SERIAL=n
CONFIG_MESHTASTIC_GNSS=n
CONFIG_MESHTASTIC_MQTT=n
CONFIG_MESHTASTIC_RELIABLE=y

CONFIG_SENSOR=y
CONFIG_MESHTASTIC_NODEDB=y
CONFIG_MESHTASTIC_MESSAGE=y
CONFIG_MESHTASTIC_NODEINFO=y
CONFIG_MESHTASTIC_NODEINFO_AUTO_SEND=n
CONFIG_MESHTASTIC_DEVICE_METRICS=y
CONFIG_MESHTASTIC_DEVICE_METRICS_AUTO_SEND=n
CONFIG_MESHTASTIC_ENVIRONMENT_METRICS=y
CONFIG_MESHTASTIC_ENVIRONMENT_METRICS_AUTO_SEND=n

CONFIG_MESHTASTIC_NODE_ID_CUSTOM=y

CONFIG_MAIN_STACK_SIZE=4096
```

## src/main.c
```c
/* SPDX-FileCopyrightText: Benjamin Cabé <kartben@gmail.com>
 * SPDX-License-Identifier: GPL-3.0
 */

#include <string.h>

#include <zephyr/kernel.h>
#include <zephyr/shell/shell.h>
#include <zephyr/shell/shell_dummy.h>
#include <zephyr/ztest.h>

#include <zephyr/meshtastic/meshtastic.h>

#include "meshtastic_channels.h"
#include "meshtastic_config_store.h"
#include "meshtastic_core.h"
#include "meshtastic_packet.h"

#include "mock_lora.h"

#define TEST_NODE_ID 0x12345678U
#define PEER_NODE_ID 0x87654321U

#define TEST_PSK_HEX "000102030405060708090a0b0c0d0e0f"

static struct meshtastic_config cfg = {
	.node_id = TEST_NODE_ID,
	.psk = meshtastic_default_psk,
	.psk_len = sizeof(meshtastic_default_psk),
	.channel_name = MESHTASTIC_CHANNEL_LONGFAST,
	.frequency = MESHTASTIC_FREQ_EU,
	.long_name = "Zephyr Test Node",
	.short_name = "ZTN",
};

static const struct shell *sh;
static char captured[4096];
static size_t captured_len;

/*
 * Reading the dummy backend drains it, so keep our own copy: a command's
 * output can arrive in several chunks once the shell thread flushes.
 */
static bool output_contains(const char *needle)
{
	size_t len;
	const char *chunk = shell_backend_dummy_get_output(sh, &len);

	if (len > 0U && (captured_len + len) < sizeof(captured)) {
		memcpy(&captured[captured_len], chunk, len);
		captured_len += len;
		captured[captured_len] = '\0';
	}

	return strstr(captured, needle) != NULL;
}

static void assert_output_contains(const char *needle)
{
	WAIT_FOR(output_contains(needle), 500000, k_msleep(1));
	zassert_true(output_contains(needle), "expected \"%s\" in:\n%s", needle, captured);
}

/* Run a command and return the shell's exit code. */
static int run(const char *cmd)
{
	/* Let whatever the previous command printed land before dropping it. */
	k_msleep(20);
	shell_backend_dummy_clear_output(sh);
	captured_len = 0U;
	captured[0] = '\0';

	return shell_execute_cmd(sh, cmd);
}

/* Deferred commands are handed to a worker thread; wait for the frame it sends. */
static void decode_deferred_tx(struct meshtastic_packet *packet, uint8_t *payload,
			       size_t payload_len)
{
	uint8_t wire[MESHTASTIC_PKT_MAX];
	uint32_t wire_len;

	zassert_true(mock_lora_wait_for_send_count(1U, K_MSEC(1000)),
		     "the radio did not transmit in time");
	wire_len = mock_lora_last_tx(wire, sizeof(wire));
	zassert_ok(meshtastic_decode_wire_packet(wire, (int)wire_len, 0, 0, packet, payload,
						 payload_len),
		   "could not decode the transmitted frame");
}

static void *setup(void)
{
	cfg.lora_dev = mock_lora_device();
	zassert_ok(meshtastic_init(&cfg), "meshtastic_init failed");

	sh = shell_backend_dummy_get_ptr();
	zassert_not_null(sh, "dummy shell backend missing");
	/* The dummy backend needs one processing pass before it accepts commands. */
	shell_process(sh);

	return NULL;
}

static void before(void *fixture)
{
	ARG_UNUSED(fixture);

	zassert_ok(meshtastic_channels_init_from_config(&cfg));
	zassert_ok(meshtastic_config_store_seed(&cfg));
	meshtastic_set_device_role(meshtastic_Config_DeviceConfig_Role_CLIENT);
	meshtastic_set_rebroadcast_mode(meshtastic_Config_DeviceConfig_RebroadcastMode_ALL);
	mock_lora_reset();
	shell_backend_dummy_clear_output(sh);
	captured_len = 0U;
	captured[0] = '\0';
}

ZTEST_SUITE(shell_commands, NULL, setup, before, NULL, NULL);

ZTEST(shell_commands, test_status_reports_the_node_and_the_primary_channel)
{
	zassert_ok(run("meshtastic status"));

	assert_output_contains("node: 0x12345678");
	assert_output_contains("initialized: yes");
	assert_output_contains("primary channel: 0 \"LongFast\" hash=0x08");
	assert_output_contains("device role: client");
	assert_output_contains("rebroadcast mode: all");
	assert_output_contains("rebroadcasting: yes");
}

ZTEST(shell_commands, test_channel_list_shows_every_slot)
{
	zassert_ok(run("meshtastic channel list"));

	assert_output_contains("[0] role=primary name=\"LongFast\" hash=0x08");
	assert_output_contains("[7] role=disabled");
}

ZTEST(shell_commands, test_channel_show_prints_the_key_material)
{
	zassert_ok(run("meshtastic channel show 0"));

	assert_output_contains("role: primary");
	assert_output_contains("name: \"LongFast\"");
	assert_output_contains("hash: 0x08");
	assert_output_contains("psk hex: d4f1bb3a20290759f0bcffabcf4e6901");
}

ZTEST(shell_commands, test_channel_show_rejects_a_bad_index)
{
	zassert_equal(run("meshtastic channel show 8"), -EINVAL);
	assert_output_contains("invalid channel index: 8");

	zassert_equal(run("meshtastic channel show"), -EINVAL);
	assert_output_contains("usage:");
}

ZTEST(shell_commands, test_channel_set_updates_a_slot)
{
	zassert_ok(run("meshtastic channel set 1 name Private role secondary psk default "
		       "uplink on downlink off"));

	assert_output_contains("channel 1 updated");
	zassert_str_equal(meshtastic_channels_get_name(1U), "Private");
	zassert_equal(meshtastic_channels_get(1U)->role, meshtastic_Channel_Role_SECONDARY);
	zassert_true(meshtastic_channels_uplink_enabled(1U));
	zassert_false(meshtastic_channels_downlink_enabled(1U));
}

ZTEST(shell_commands, test_channel_set_accepts_a_hex_key)
{
	struct meshtastic_channel_key key;

	zassert_ok(run("meshtastic channel set 1 role secondary psk hex " TEST_PSK_HEX));

	zassert_ok(meshtastic_channels_get_key(1U, &key));
	zassert_equal(key.len, 16U);
	zassert_equal(key.bytes[0], 0x00U);
	zassert_equal(key.bytes[15], 0x0FU);
}

ZTEST(shell_commands, test_channel_set_rejects_bad_arguments)
{
	zassert_equal(run("meshtastic channel set 1"), -EINVAL);
	assert_output_contains("usage:");

	zassert_equal(run("meshtastic channel set 1 name"), -EINVAL);
	assert_output_contains("name requires a value");

	zassert_equal(run("meshtastic channel set 1 role bogus"), -EINVAL);
	assert_output_contains("invalid channel role: bogus");

	zassert_equal(run("meshtastic channel set 1 psk 11"), -EINVAL);
	assert_output_contains("invalid psk: 11");

	zassert_equal(run("meshtastic channel set 1 psk hex abcd"), -EINVAL);
	assert_output_contains("psk hex must be 32 or 64 characters");

	zassert_equal(run("meshtastic channel set 1 psk hex "
			  "zz0102030405060708090a0b0c0d0e0f"),
		      -EINVAL);
	assert_output_contains("invalid hex in psk");

	zassert_equal(run("meshtastic channel set 1 bogus on"), -EINVAL);
	assert_output_contains("unknown option: bogus");
}

ZTEST(shell_commands, test_channel_disable_clears_a_slot)
{
	zassert_ok(run("meshtastic channel set 1 role secondary name Private"));
	zassert_ok(run("meshtastic channel disable 1"));

	assert_output_contains("channel 1 disabled");
	zassert_equal(meshtastic_channels_get(1U)->role, meshtastic_Channel_Role_DISABLED);

	zassert_equal(run("meshtastic channel disable"), -EINVAL);
}

ZTEST(shell_commands, test_device_role_can_be_read_and_written)
{
	zassert_ok(run("meshtastic device role"));
	assert_output_contains("role: client");

	zassert_ok(run("meshtastic device role router"));
	assert_output_contains("role set to router");
	zassert_equal(meshtastic_device_role(), meshtastic_Config_DeviceConfig_Role_ROUTER);

	zassert_equal(run("meshtastic device role bogus"), -EINVAL);
	assert_output_contains("invalid device role: bogus");
}

ZTEST(shell_commands, test_rebroadcast_mode_can_be_read_and_written)
{
	zassert_ok(run("meshtastic device rebroadcast"));
	assert_output_contains("rebroadcast: all");

	zassert_ok(run("meshtastic device rebroadcast known_only"));
	assert_output_contains("rebroadcast set to known_only");
	zassert_equal(meshtastic_rebroadcast_mode(),
		      meshtastic_Config_DeviceConfig_RebroadcastMode_KNOWN_ONLY);

	zassert_equal(run("meshtastic device rebroadcast bogus"), -EINVAL);
	assert_output_contains("invalid rebroadcast mode: bogus");
}

ZTEST(shell_commands, test_nodedb_lists_and_shows_the_local_node)
{
	zassert_ok(run("meshtastic nodedb list"));
	assert_output_contains("0x12345678");

	zassert_ok(run("meshtastic nodedb show 0x12345678"));
	assert_output_contains("node: 0x12345678");
	assert_output_contains("long name: Zephyr Test Node");
	assert_output_contains("short name: ZTN");

	zassert_true(run("meshtastic nodedb show 0xdeadbeef") < 0);
	assert_output_contains("not found");

	zassert_equal(run("meshtastic nodedb show"), -EINVAL);
	zassert_equal(run("meshtastic nodedb show notanumber"), -EINVAL);
	assert_output_contains("invalid integer: notanumber");
}

ZTEST(shell_commands, test_text_send_broadcasts_the_message)
{
	struct meshtastic_packet sent;
	uint8_t payload[MESHTASTIC_MAX_PAYLOAD_LEN];

	zassert_ok(run("meshtastic text send broadcast hello mesh"));
	assert_output_contains("queued");

	decode_deferred_tx(&sent, payload, sizeof(payload));
	zassert_equal(sent.to, MESHTASTIC_NODE_BROADCAST);
	zassert_equal(sent.portnum, MESHTASTIC_PORT_TEXT_MESSAGE);
	zassert_equal(sent.payload_len, strlen("hello mesh"));
	zassert_mem_equal(payload, "hello mesh", strlen("hello mesh"),
			  "arguments should be rejoined with spaces");
}

ZTEST(shell_commands, test_a_lone_word_is_broadcast_without_naming_a_destination)
{
	struct meshtastic_packet sent;
	uint8_t payload[MESHTASTIC_MAX_PAYLOAD_LEN];

	zassert_ok(run("meshtastic text send hello"));

	decode_deferred_tx(&sent, payload, sizeof(payload));
	zassert_equal(sent.to, MESHTASTIC_NODE_BROADCAST);
	zassert_equal(sent.payload_len, strlen("hello"));
}

ZTEST(shell_commands, test_text_send_honours_the_destination_and_channel)
{
	struct meshtastic_packet sent;
	uint8_t payload[MESHTASTIC_MAX_PAYLOAD_LEN];

	zassert_ok(run("meshtastic channel set 1 role secondary name Private"));
	mock_lora_reset();

	zassert_ok(run("meshtastic text send -c 1 0x87654321 hi"));

	decode_deferred_tx(&sent, payload, sizeof(payload));
	zassert_equal(sent.to, PEER_NODE_ID);
	zassert_equal(sent.channel_index, 1U);
}

ZTEST(shell_commands, test_text_send_can_request_an_acknowledgement)
{
	struct meshtastic_packet sent;
	uint8_t payload[MESHTASTIC_MAX_PAYLOAD_LEN];

	zassert_ok(run("meshtastic text send -a 0x87654321 ack me"));

	decode_deferred_tx(&sent, payload, sizeof(payload));
	zassert_true(sent.want_ack);
}

ZTEST(shell_commands, test_text_send_drops_the_ack_request_on_a_broadcast)
{
	struct meshtastic_packet sent;
	uint8_t payload[MESHTASTIC_MAX_PAYLOAD_LEN];

	zassert_ok(run("meshtastic text send -a broadcast hello"));
	assert_output_contains("broadcasts are not acknowledged");

	decode_deferred_tx(&sent, payload, sizeof(payload));
	zassert_false(sent.want_ack);
}

ZTEST(shell_commands, test_text_send_accepts_a_maximum_length_message)
{
	char cmd[64 + MESHTASTIC_MAX_TEXT_LEN];
	struct meshtastic_packet sent;
	uint8_t payload[MESHTASTIC_MAX_PAYLOAD_LEN];
	size_t prefix;

	strcpy(cmd, "meshtastic text send broadcast ");
	prefix = strlen(cmd);
	memset(&cmd[prefix], 'x', MESHTASTIC_MAX_TEXT_LEN);
	cmd[prefix + MESHTASTIC_MAX_TEXT_LEN] = '\0';

	zassert_ok(run(cmd));

	decode_deferred_tx(&sent, payload, sizeof(payload));
	zassert_equal(sent.payload_len, MESHTASTIC_MAX_TEXT_LEN);
	zassert_mem_equal(payload, &cmd[prefix], MESHTASTIC_MAX_TEXT_LEN);
}

ZTEST(shell_commands, test_text_send_rejects_bad_arguments)
{
	char long_message[64 + MESHTASTIC_MAX_TEXT_LEN];

	zassert_equal(run("meshtastic text send"), -EINVAL);
	zassert_equal(run("meshtastic text send -c"), -EINVAL);
	zassert_equal(run("meshtastic text send -c 9 hello"), -EINVAL);
	assert_output_contains("invalid channel index: 9");

	zassert_equal(run("meshtastic text send notanumber hello"), -EINVAL);
	assert_output_contains("invalid integer: notanumber");

	strcpy(long_message, "meshtastic text send broadcast ");
	memset(long_message + strlen(long_message), 'x', MESHTASTIC_MAX_TEXT_LEN + 1U);
	long_message[strlen("meshtastic text send broadcast ") + MESHTASTIC_MAX_TEXT_LEN + 1U] =
		'\0';
	zassert_true(run(long_message) < 0);
	assert_output_contains("message too long");
}

ZTEST(shell_commands, test_metrics_send_queues_a_telemetry_packet)
{
	struct meshtastic_packet sent;
	uint8_t payload[MESHTASTIC_MAX_PAYLOAD_LEN];

	zassert_ok(run("meshtastic metrics send"));
	assert_output_contains("queued");

	decode_deferred_tx(&sent, payload, sizeof(payload));
	zassert_equal(sent.portnum, MESHTASTIC_PORT_TELEMETRY);
	zassert_equal(sent.to, MESHTASTIC_NODE_BROADCAST);
}

ZTEST(shell_commands, test_nodeinfo_send_queues_an_announcement)
{
	struct meshtastic_packet sent;
	uint8_t payload[MESHTASTIC_MAX_PAYLOAD_LEN];

	zassert_ok(run("meshtastic nodeinfo send 0x87654321"));

	decode_deferred_tx(&sent, payload, sizeof(payload));
	zassert_equal(sent.portnum, MESHTASTIC_PORT_NODEINFO);
	zassert_equal(sent.to, PEER_NODE_ID);
}

ZTEST(shell_commands, test_a_deferred_send_reports_a_failure)
{
	zassert_ok(run("meshtastic environment send"));

	k_msleep(200);
	zassert_equal(mock_lora_send_count(), 0U);
	assert_output_contains("no sensor readings available");
}

ZTEST(shell_commands, test_deferred_commands_reject_extra_arguments)
{
	zassert_equal(run("meshtastic metrics send broadcast extra"), -EINVAL);
	assert_output_contains("too many arguments");
}
```

## src/channel_psk.c
```c
/* SPDX-FileCopyrightText: Benjamin Cabé <kartben@gmail.com>
 * SPDX-License-Identifier: GPL-3.0
 */

/**
 * @file
 * @brief How "channel show" describes each kind of pre-shared key.
 */

#include <zephyr/ztest.h>

#include "shell_fixture.h"

#define KEY_128 "000102030405060708090a0b0c0d0e0f"
#define KEY_256 KEY_128 KEY_128

ZTEST_SUITE(shell_channel_psk, NULL, shell_test_setup, shell_test_before, NULL, NULL);

ZTEST(shell_channel_psk, test_a_primary_without_a_key_is_cleartext)
{
	zassert_ok(shell_run("meshtastic channel set 0 psk none"));

	zassert_ok(shell_run("meshtastic channel show 0"));
	shell_expect("psk: cleartext\r\n");
}

ZTEST(shell_channel_psk, test_a_secondary_without_a_key_inherits_the_primary)
{
	zassert_ok(shell_run("meshtastic channel set 1 role secondary name Private psk none"));

	zassert_ok(shell_run("meshtastic channel show 1"));
	shell_expect("psk: inherit primary\r\n");
}

ZTEST(shell_channel_psk, test_the_default_key_is_shorthand_one)
{
	zassert_ok(shell_run("meshtastic channel set 0 psk default"));

	zassert_ok(shell_run("meshtastic channel show 0"));
	shell_expect("psk: shorthand 1\r\n");
}

ZTEST(shell_channel_psk, test_a_numbered_key_is_shorthand)
{
	zassert_ok(shell_run("meshtastic channel set 0 psk 7"));

	zassert_ok(shell_run("meshtastic channel show 0"));
	shell_expect("psk: shorthand 7\r\n");
}

ZTEST(shell_channel_psk, test_a_128_bit_key_is_printed_in_full)
{
	zassert_ok(shell_run("meshtastic channel set 0 psk hex " KEY_128));

	zassert_ok(shell_run("meshtastic channel show 0"));
	shell_expect("psk: 16-byte key\r\n");
	shell_expect("psk hex: " KEY_128 "\r\n");
}

ZTEST(shell_channel_psk, test_a_256_bit_key_is_printed_in_full)
{
	zassert_ok(shell_run("meshtastic channel set 0 psk hex " KEY_256));

	zassert_ok(shell_run("meshtastic channel show 0"));
	shell_expect("psk: 32-byte key\r\n");
	shell_expect("psk hex: " KEY_256 "\r\n");
}

ZTEST(shell_channel_psk, test_a_disabled_channel_reports_no_usable_key)
{
	zassert_ok(shell_run("meshtastic channel set 1 role secondary name Private psk default"));
	zassert_ok(shell_run("meshtastic channel disable 1"));

	zassert_ok(shell_run("meshtastic channel show 1"));
	shell_expect("psk: n/a\r\n");
}
```

## src/commands.c
```c
/* SPDX-FileCopyrightText: Benjamin Cabé <kartben@gmail.com>
 * SPDX-License-Identifier: GPL-3.0
 */

/**
 * @file
 * @brief The meshtastic shell commands, from status through to text send.
 */

#include <string.h>

#include <zephyr/ztest.h>

#include "meshtastic_channels.h"
#include "meshtastic_core.h"
#include "meshtastic_packet.h"

#include "mock_lora.h"
#include "shell_fixture.h"

#define TEST_PSK_HEX "000102030405060708090a0b0c0d0e0f"

ZTEST_SUITE(shell_commands, NULL, shell_test_setup, shell_test_before, NULL, NULL);


ZTEST(shell_commands, test_status_reports_the_node_and_the_primary_channel)
{
	zassert_ok(shell_run("meshtastic status"));

	shell_expect("node: 0x12345678");
	shell_expect("initialized: yes");
	shell_expect("primary channel: 0 \"LongFast\" hash=0x08");
	shell_expect("device role: client");
	shell_expect("rebroadcast mode: all");
	shell_expect("rebroadcasting: yes");
}

ZTEST(shell_commands, test_channel_list_shows_every_slot)
{
	zassert_ok(shell_run("meshtastic channel list"));

	shell_expect("[0] role=primary name=\"LongFast\" hash=0x08");
	shell_expect("[7] role=disabled");
}

ZTEST(shell_commands, test_channel_show_prints_the_key_material)
{
	zassert_ok(shell_run("meshtastic channel show 0"));

	shell_expect("role: primary");
	shell_expect("name: \"LongFast\"");
	shell_expect("hash: 0x08");
	shell_expect("psk hex: d4f1bb3a20290759f0bcffabcf4e6901");
}

ZTEST(shell_commands, test_channel_show_rejects_a_bad_index)
{
	zassert_equal(shell_run("meshtastic channel show 8"), -EINVAL);
	shell_expect("invalid channel index: 8");

	zassert_equal(shell_run("meshtastic channel show"), -EINVAL);
	shell_expect("usage:");
}

ZTEST(shell_commands, test_channel_set_updates_a_slot)
{
	zassert_ok(shell_run("meshtastic channel set 1 name Private role secondary psk default "
		       "uplink on downlink off"));

	shell_expect("channel 1 updated");
	zassert_str_equal(meshtastic_channels_get_name(1U), "Private");
	zassert_equal(meshtastic_channels_get(1U)->role, meshtastic_Channel_Role_SECONDARY);
	zassert_true(meshtastic_channels_uplink_enabled(1U));
	zassert_false(meshtastic_channels_downlink_enabled(1U));
}

ZTEST(shell_commands, test_channel_set_accepts_a_hex_key)
{
	struct meshtastic_channel_key key;

	zassert_ok(shell_run("meshtastic channel set 1 role secondary psk hex " TEST_PSK_HEX));

	zassert_ok(meshtastic_channels_get_key(1U, &key));
	zassert_equal(key.len, 16U);
	zassert_equal(key.bytes[0], 0x00U);
	zassert_equal(key.bytes[15], 0x0FU);
}

ZTEST(shell_commands, test_channel_set_rejects_bad_arguments)
{
	zassert_equal(shell_run("meshtastic channel set 1"), -EINVAL);
	shell_expect("usage:");

	zassert_equal(shell_run("meshtastic channel set 1 name"), -EINVAL);
	shell_expect("name requires a value");

	zassert_equal(shell_run("meshtastic channel set 1 role bogus"), -EINVAL);
	shell_expect("invalid channel role: bogus");

	zassert_equal(shell_run("meshtastic channel set 1 psk 11"), -EINVAL);
	shell_expect("invalid psk: 11");

	zassert_equal(shell_run("meshtastic channel set 1 psk hex abcd"), -EINVAL);
	shell_expect("psk hex must be 32 or 64 characters");

	zassert_equal(shell_run("meshtastic channel set 1 psk hex "
			  "zz0102030405060708090a0b0c0d0e0f"),
		      -EINVAL);
	shell_expect("invalid hex in psk");

	zassert_equal(shell_run("meshtastic channel set 1 bogus on"), -EINVAL);
	shell_expect("unknown option: bogus");
}

ZTEST(shell_commands, test_channel_disable_clears_a_slot)
{
	zassert_ok(shell_run("meshtastic channel set 1 role secondary name Private"));
	zassert_ok(shell_run("meshtastic channel disable 1"));

	shell_expect("channel 1 disabled");
	zassert_equal(meshtastic_channels_get(1U)->role, meshtastic_Channel_Role_DISABLED);

	zassert_equal(shell_run("meshtastic channel disable"), -EINVAL);
}

ZTEST(shell_commands, test_device_role_can_be_read_and_written)
{
	zassert_ok(shell_run("meshtastic device role"));
	shell_expect("role: client");

	zassert_ok(shell_run("meshtastic device role router"));
	shell_expect("role set to router");
	zassert_equal(meshtastic_device_role(), meshtastic_Config_DeviceConfig_Role_ROUTER);

	zassert_equal(shell_run("meshtastic device role bogus"), -EINVAL);
	shell_expect("invalid device role: bogus");
}

ZTEST(shell_commands, test_rebroadcast_mode_can_be_read_and_written)
{
	zassert_ok(shell_run("meshtastic device rebroadcast"));
	shell_expect("rebroadcast: all");

	zassert_ok(shell_run("meshtastic device rebroadcast known_only"));
	shell_expect("rebroadcast set to known_only");
	zassert_equal(meshtastic_rebroadcast_mode(),
		      meshtastic_Config_DeviceConfig_RebroadcastMode_KNOWN_ONLY);

	zassert_equal(shell_run("meshtastic device rebroadcast bogus"), -EINVAL);
	shell_expect("invalid rebroadcast mode: bogus");
}

ZTEST(shell_commands, test_nodedb_lists_and_shows_the_local_node)
{
	zassert_ok(shell_run("meshtastic nodedb list"));
	shell_expect("0x12345678");

	zassert_ok(shell_run("meshtastic nodedb show 0x12345678"));
	shell_expect("node: 0x12345678");
	shell_expect("long name: Zephyr Test Node");
	shell_expect("short name: ZTN");

	zassert_true(shell_run("meshtastic nodedb show 0xdeadbeef") < 0);
	shell_expect("not found");

	zassert_equal(shell_run("meshtastic nodedb show"), -EINVAL);
	zassert_equal(shell_run("meshtastic nodedb show notanumber"), -EINVAL);
	shell_expect("invalid integer: notanumber");
}

ZTEST(shell_commands, test_text_send_broadcasts_the_message)
{
	struct meshtastic_packet sent;
	uint8_t payload[MESHTASTIC_MAX_PAYLOAD_LEN];

	zassert_ok(shell_run("meshtastic text send broadcast hello mesh"));
	shell_expect("queued");

	shell_deferred_tx(&sent, payload, sizeof(payload));
	zassert_equal(sent.to, MESHTASTIC_NODE_BROADCAST);
	zassert_equal(sent.portnum, MESHTASTIC_PORT_TEXT_MESSAGE);
	zassert_equal(sent.payload_len, strlen("hello mesh"));
	zassert_mem_equal(payload, "hello mesh", strlen("hello mesh"),
			  "arguments should be rejoined with spaces");
}

ZTEST(shell_commands, test_a_lone_word_is_broadcast_without_naming_a_destination)
{
	struct meshtastic_packet sent;
	uint8_t payload[MESHTASTIC_MAX_PAYLOAD_LEN];

	zassert_ok(shell_run("meshtastic text send hello"));

	shell_deferred_tx(&sent, payload, sizeof(payload));
	zassert_equal(sent.to, MESHTASTIC_NODE_BROADCAST);
	zassert_equal(sent.payload_len, strlen("hello"));
}

ZTEST(shell_commands, test_text_send_honours_the_destination_and_channel)
{
	struct meshtastic_packet sent;
	uint8_t payload[MESHTASTIC_MAX_PAYLOAD_LEN];

	zassert_ok(shell_run("meshtastic channel set 1 role secondary name Private"));
	mock_lora_reset();

	zassert_ok(shell_run("meshtastic text send -c 1 0x87654321 hi"));

	shell_deferred_tx(&sent, payload, sizeof(payload));
	zassert_equal(sent.to, SHELL_TEST_PEER_ID);
	zassert_equal(sent.channel_index, 1U);
}

ZTEST(shell_commands, test_text_send_can_request_an_acknowledgement)
{
	struct meshtastic_packet sent;
	uint8_t payload[MESHTASTIC_MAX_PAYLOAD_LEN];

	zassert_ok(shell_run("meshtastic text send -a 0x87654321 ack me"));

	shell_deferred_tx(&sent, payload, sizeof(payload));
	zassert_true(sent.want_ack);
}

ZTEST(shell_commands, test_text_send_drops_the_ack_request_on_a_broadcast)
{
	struct meshtastic_packet sent;
	uint8_t payload[MESHTASTIC_MAX_PAYLOAD_LEN];

	zassert_ok(shell_run("meshtastic text send -a broadcast hello"));
	shell_expect("broadcasts are not acknowledged");

	shell_deferred_tx(&sent, payload, sizeof(payload));
	zassert_false(sent.want_ack);
}

ZTEST(shell_commands, test_text_send_accepts_a_maximum_length_message)
{
	char cmd[64 + MESHTASTIC_MAX_TEXT_LEN];
	struct meshtastic_packet sent;
	uint8_t payload[MESHTASTIC_MAX_PAYLOAD_LEN];
	size_t prefix;

	strcpy(cmd, "meshtastic text send broadcast ");
	prefix = strlen(cmd);
	memset(&cmd[prefix], 'x', MESHTASTIC_MAX_TEXT_LEN);
	cmd[prefix + MESHTASTIC_MAX_TEXT_LEN] = '\0';

	zassert_ok(shell_run(cmd));

	shell_deferred_tx(&sent, payload, sizeof(payload));
	zassert_equal(sent.payload_len, MESHTASTIC_MAX_TEXT_LEN);
	zassert_mem_equal(payload, &cmd[prefix], MESHTASTIC_MAX_TEXT_LEN);
}

ZTEST(shell_commands, test_text_send_rejects_bad_arguments)
{
	char long_message[64 + MESHTASTIC_MAX_TEXT_LEN];

	zassert_equal(shell_run("meshtastic text send"), -EINVAL);
	zassert_equal(shell_run("meshtastic text send -c"), -EINVAL);
	zassert_equal(shell_run("meshtastic text send -c 9 hello"), -EINVAL);
	shell_expect("invalid channel index: 9");

	zassert_equal(shell_run("meshtastic text send notanumber hello"), -EINVAL);
	shell_expect("invalid integer: notanumber");

	strcpy(long_message, "meshtastic text send broadcast ");
	memset(long_message + strlen(long_message), 'x', MESHTASTIC_MAX_TEXT_LEN + 1U);
	long_message[strlen("meshtastic text send broadcast ") + MESHTASTIC_MAX_TEXT_LEN + 1U] =
		'\0';
	zassert_true(shell_run(long_message) < 0);
	shell_expect("message too long");
}

ZTEST(shell_commands, test_metrics_send_queues_a_telemetry_packet)
{
	struct meshtastic_packet sent;
	uint8_t payload[MESHTASTIC_MAX_PAYLOAD_LEN];

	zassert_ok(shell_run("meshtastic metrics send"));
	shell_expect("queued");

	shell_deferred_tx(&sent, payload, sizeof(payload));
	zassert_equal(sent.portnum, MESHTASTIC_PORT_TELEMETRY);
	zassert_equal(sent.to, MESHTASTIC_NODE_BROADCAST);
}

ZTEST(shell_commands, test_nodeinfo_send_queues_an_announcement)
{
	struct meshtastic_packet sent;
	uint8_t payload[MESHTASTIC_MAX_PAYLOAD_LEN];

	zassert_ok(shell_run("meshtastic nodeinfo send 0x87654321"));

	shell_deferred_tx(&sent, payload, sizeof(payload));
	zassert_equal(sent.portnum, MESHTASTIC_PORT_NODEINFO);
	zassert_equal(sent.to, SHELL_TEST_PEER_ID);
}

ZTEST(shell_commands, test_a_deferred_send_reports_a_failure)
{
	zassert_ok(shell_run("meshtastic environment send"));

	k_msleep(200);
	zassert_equal(mock_lora_send_count(), 0U);
	shell_expect("no sensor readings available");
}

ZTEST(shell_commands, test_deferred_commands_reject_extra_arguments)
{
	zassert_equal(shell_run("meshtastic metrics send broadcast extra"), -EINVAL);
	shell_expect("too many arguments");
}
```

## src/names.c
```c
/* SPDX-FileCopyrightText: Benjamin Cabé <kartben@gmail.com>
 * SPDX-License-Identifier: GPL-3.0
 */

/**
 * @file
 * @brief The names the shell accepts and prints for roles and modes.
 *
 * The lists below are the Meshtastic enums lowercased, and every one of them
 * has to survive a trip out to the shell and back.
 */

#include <zephyr/sys/util.h>
#include <zephyr/ztest.h>

#include "meshtastic_channels.h"
#include "meshtastic_core.h"

#include "shell_fixture.h"

static const struct {
	const char *name;
	meshtastic_Config_DeviceConfig_Role role;
} device_roles[] = {
	{"client", meshtastic_Config_DeviceConfig_Role_CLIENT},
	{"client_mute", meshtastic_Config_DeviceConfig_Role_CLIENT_MUTE},
	{"router", meshtastic_Config_DeviceConfig_Role_ROUTER},
	{"router_late", meshtastic_Config_DeviceConfig_Role_ROUTER_LATE},
	{"client_base", meshtastic_Config_DeviceConfig_Role_CLIENT_BASE},
	{"sensor", meshtastic_Config_DeviceConfig_Role_SENSOR},
	{"tracker", meshtastic_Config_DeviceConfig_Role_TRACKER},
	{"tak", meshtastic_Config_DeviceConfig_Role_TAK},
	{"client_hidden", meshtastic_Config_DeviceConfig_Role_CLIENT_HIDDEN},
	{"lost_and_found", meshtastic_Config_DeviceConfig_Role_LOST_AND_FOUND},
	{"tak_tracker", meshtastic_Config_DeviceConfig_Role_TAK_TRACKER},
};

static const struct {
	const char *name;
	meshtastic_Config_DeviceConfig_RebroadcastMode mode;
} rebroadcast_modes[] = {
	{"all", meshtastic_Config_DeviceConfig_RebroadcastMode_ALL},
	{"all_skip_decoding", meshtastic_Config_DeviceConfig_RebroadcastMode_ALL_SKIP_DECODING},
	{"local_only", meshtastic_Config_DeviceConfig_RebroadcastMode_LOCAL_ONLY},
	{"known_only", meshtastic_Config_DeviceConfig_RebroadcastMode_KNOWN_ONLY},
	{"none", meshtastic_Config_DeviceConfig_RebroadcastMode_NONE},
	{"core_portnums_only",
	 meshtastic_Config_DeviceConfig_RebroadcastMode_CORE_PORTNUMS_ONLY},
};

ZTEST_SUITE(shell_names, NULL, shell_test_setup, shell_test_before, NULL, NULL);

ZTEST(shell_names, test_every_device_role_can_be_set_by_name)
{
	ARRAY_FOR_EACH(device_roles, i) {
		char cmd[64];

		snprintk(cmd, sizeof(cmd), "meshtastic device role %s", device_roles[i].name);

		zassert_ok(shell_run(cmd), "the shell rejected role %s", device_roles[i].name);
		zassert_equal(meshtastic_device_role(), device_roles[i].role);
	}
}

ZTEST(shell_names, test_every_device_role_prints_its_own_name)
{
	ARRAY_FOR_EACH(device_roles, i) {
		char expected[64];

		meshtastic_set_device_role(device_roles[i].role);

		zassert_ok(shell_run("meshtastic device role"));
		snprintk(expected, sizeof(expected), "role: %s\r\n", device_roles[i].name);
		shell_expect(expected);
	}
}

ZTEST(shell_names, test_every_rebroadcast_mode_can_be_set_by_name)
{
	ARRAY_FOR_EACH(rebroadcast_modes, i) {
		char cmd[64];

		snprintk(cmd, sizeof(cmd), "meshtastic device rebroadcast %s",
			 rebroadcast_modes[i].name);

		zassert_ok(shell_run(cmd), "the shell rejected mode %s",
			   rebroadcast_modes[i].name);
		zassert_equal(meshtastic_rebroadcast_mode(), rebroadcast_modes[i].mode);
	}
}

ZTEST(shell_names, test_every_rebroadcast_mode_prints_its_own_name)
{
	ARRAY_FOR_EACH(rebroadcast_modes, i) {
		char expected[64];

		meshtastic_set_rebroadcast_mode(rebroadcast_modes[i].mode);

		zassert_ok(shell_run("meshtastic device rebroadcast"));
		snprintk(expected, sizeof(expected), "rebroadcast: %s\r\n",
			 rebroadcast_modes[i].name);
		shell_expect(expected);
	}
}
```

## src/nodedb_show.c
```c
/* SPDX-FileCopyrightText: Benjamin Cabé <kartben@gmail.com>
 * SPDX-License-Identifier: GPL-3.0
 */

/**
 * @file
 * @brief What "nodedb show" prints once a peer has been heard from.
 */

#include <zephyr/ztest.h>

#include <pb_encode.h>

#include "meshtastic_core.h"
#include "meshtastic_modules.h"

#include "shell_fixture.h"

#include "meshtastic/telemetry.pb.h"

int meshtastic_nodedb_init(void);

#define SHOW_PEER "meshtastic nodedb show 0x87654321"

static uint8_t payload[MESHTASTIC_MAX_PAYLOAD_LEN];

static void deliver(uint32_t portnum, const pb_msgdesc_t *fields, const void *message)
{
	pb_ostream_t stream = pb_ostream_from_buffer(payload, sizeof(payload));
	struct meshtastic_packet packet = {
		.from = SHELL_TEST_PEER_ID,
		.to = MESHTASTIC_NODE_BROADCAST,
		.portnum = portnum,
		.payload = payload,
	};

	zassert_true(pb_encode(&stream, fields, message), "protobuf encode failed");
	packet.payload_len = stream.bytes_written;

	meshtastic_dispatch_modules(&packet);
}

static void introduce_peer(void)
{
	meshtastic_User user = meshtastic_User_init_zero;

	snprintk(user.id, sizeof(user.id), "!%08x", SHELL_TEST_PEER_ID);
	strcpy(user.long_name, "Peer Node");
	strcpy(user.short_name, "PEER");
	user.hw_model = meshtastic_HardwareModel_TBEAM;

	deliver(MESHTASTIC_PORT_NODEINFO, meshtastic_User_fields, &user);
}

static void deliver_environment(float temperature)
{
	meshtastic_Telemetry telemetry = meshtastic_Telemetry_init_zero;

	telemetry.which_variant = meshtastic_Telemetry_environment_metrics_tag;
	telemetry.variant.environment_metrics.has_temperature = true;
	telemetry.variant.environment_metrics.temperature = temperature;
	telemetry.variant.environment_metrics.has_relative_humidity = true;
	telemetry.variant.environment_metrics.relative_humidity = 48.0f;
	telemetry.variant.environment_metrics.has_barometric_pressure = true;
	telemetry.variant.environment_metrics.barometric_pressure = 1013.25f;

	deliver(MESHTASTIC_PORT_TELEMETRY, meshtastic_Telemetry_fields, &telemetry);
}

static void before(void *fixture)
{
	shell_test_before(fixture);
	zassert_ok(meshtastic_nodedb_init(), "nodedb reset failed");
	introduce_peer();
}

ZTEST_SUITE(shell_nodedb_show, NULL, shell_test_setup, before, NULL, NULL);

ZTEST(shell_nodedb_show, test_the_last_known_fix_is_printed)
{
	meshtastic_Position position = meshtastic_Position_init_zero;

	position.has_latitude_i = true;
	position.latitude_i = 486000000;
	position.has_longitude_i = true;
	position.longitude_i = 23000000;
	position.has_altitude = true;
	position.altitude = 340;
	position.time = 1700000000U;
	position.precision_bits = 13U;

	deliver(MESHTASTIC_PORT_POSITION, meshtastic_Position_fields, &position);

	zassert_ok(shell_run(SHOW_PEER));
	shell_expect("position: lat_i=486000000 lon_i=23000000 alt=340 "
		     "time=1700000000 precision=13\r\n");
}

ZTEST(shell_nodedb_show, test_device_metrics_are_printed)
{
	meshtastic_Telemetry telemetry = meshtastic_Telemetry_init_zero;

	telemetry.which_variant = meshtastic_Telemetry_device_metrics_tag;
	telemetry.variant.device_metrics.has_battery_level = true;
	telemetry.variant.device_metrics.battery_level = 87U;
	telemetry.variant.device_metrics.has_voltage = true;
	telemetry.variant.device_metrics.voltage = 3.5f;
	telemetry.variant.device_metrics.has_uptime_seconds = true;
	telemetry.variant.device_metrics.uptime_seconds = 3600U;

	deliver(MESHTASTIC_PORT_TELEMETRY, meshtastic_Telemetry_fields, &telemetry);

	zassert_ok(shell_run(SHOW_PEER));
	shell_expect("battery: 87%\r\n");
	shell_expect("voltage: 3.500\r\n");
	shell_expect("uptime: 3600s\r\n");
}

ZTEST(shell_nodedb_show, test_environment_metrics_are_printed)
{
	deliver_environment(21.5f);

	zassert_ok(shell_run(SHOW_PEER));
	shell_expect("temperature: 21.5\r\n");
	shell_expect("humidity: 48.0\r\n");
	shell_expect("pressure: 1013.2\r\n");
}

ZTEST(shell_nodedb_show, test_a_reading_below_zero_keeps_its_sign)
{
	deliver_environment(-5.5f);

	zassert_ok(shell_run(SHOW_PEER));
	shell_expect("temperature: -5.5\r\n");
}
```

## src/shell_fixture.c
```c
/* SPDX-FileCopyrightText: Benjamin Cabé <kartben@gmail.com>
 * SPDX-License-Identifier: GPL-3.0
 */

#include <string.h>

#include <zephyr/kernel.h>
#include <zephyr/shell/shell.h>
#include <zephyr/shell/shell_dummy.h>
#include <zephyr/ztest.h>

#include "meshtastic_channels.h"
#include "meshtastic_config_store.h"
#include "meshtastic_packet.h"

#include "mock_lora.h"
#include "shell_fixture.h"

struct meshtastic_config shell_test_cfg = {
	.node_id = SHELL_TEST_NODE_ID,
	.psk = meshtastic_default_psk,
	.psk_len = sizeof(meshtastic_default_psk),
	.channel_name = MESHTASTIC_CHANNEL_LONGFAST,
	.frequency = MESHTASTIC_FREQ_EU,
	.long_name = SHELL_TEST_LONG_NAME,
	.short_name = SHELL_TEST_SHORT_NAME,
};

static const struct shell *sh;
static char captured[4096];
static size_t captured_len;

/*
 * Reading the dummy backend drains it, so keep our own copy: a command's
 * output can arrive in several chunks once the shell thread flushes.
 */
static bool output_contains(const char *needle)
{
	size_t len;
	const char *chunk = shell_backend_dummy_get_output(sh, &len);

	if (len > 0U && (captured_len + len) < sizeof(captured)) {
		memcpy(&captured[captured_len], chunk, len);
		captured_len += len;
		captured[captured_len] = '\0';
	}

	return strstr(captured, needle) != NULL;
}

void shell_expect(const char *needle)
{
	WAIT_FOR(output_contains(needle), 500000, k_msleep(1));
	zassert_true(output_contains(needle), "expected \"%s\" in:\n%s", needle, captured);
}

/* Run a command and return the shell's exit code. */
int shell_run(const char *cmd)
{
	/* Let whatever the previous command printed land before dropping it. */
	k_msleep(20);
	shell_backend_dummy_clear_output(sh);
	captured_len = 0U;
	captured[0] = '\0';

	return shell_execute_cmd(sh, cmd);
}

/* Deferred commands are handed to a worker thread; wait for the frame it sends. */
void shell_deferred_tx(struct meshtastic_packet *packet, uint8_t *payload,
		       size_t payload_len)
{
	uint8_t wire[MESHTASTIC_PKT_MAX];
	uint32_t wire_len;

	zassert_true(mock_lora_wait_for_send_count(1U, K_MSEC(1000)),
		     "the radio did not transmit in time");
	wire_len = mock_lora_last_tx(wire, sizeof(wire));
	zassert_ok(meshtastic_decode_wire_packet(wire, (int)wire_len, 0, 0, packet, payload,
						 payload_len),
		   "could not decode the transmitted frame");
}

void *shell_test_setup(void)
{
	if (sh != NULL) {
		return NULL;
	}

	shell_test_cfg.lora_dev = mock_lora_device();
	zassert_ok(meshtastic_init(&shell_test_cfg), "meshtastic_init failed");

	sh = shell_backend_dummy_get_ptr();
	zassert_not_null(sh, "dummy shell backend missing");
	/* The dummy backend needs one processing pass before it accepts commands. */
	shell_process(sh);

	return NULL;
}

void shell_test_before(void *fixture)
{
	ARG_UNUSED(fixture);

	zassert_ok(meshtastic_channels_init_from_config(&shell_test_cfg));
	zassert_ok(meshtastic_config_store_seed(&shell_test_cfg));
	meshtastic_set_device_role(meshtastic_Config_DeviceConfig_Role_CLIENT);
	meshtastic_set_rebroadcast_mode(meshtastic_Config_DeviceConfig_RebroadcastMode_ALL);
	mock_lora_reset();
	shell_backend_dummy_clear_output(sh);
	captured_len = 0U;
	captured[0] = '\0';
}
```

## src/shell_fixture.h
```c
/* SPDX-FileCopyrightText: Benjamin Cabé <kartben@gmail.com>
 * SPDX-License-Identifier: GPL-3.0
 */

/**
 * @file
 * @brief Shared setup for the shell suites.
 */

#ifndef MESHTASTIC_TESTS_SHELL_FIXTURE_H_
#define MESHTASTIC_TESTS_SHELL_FIXTURE_H_

#include <stddef.h>

#include <zephyr/meshtastic/meshtastic.h>

#include "meshtastic_core.h"

#define SHELL_TEST_NODE_ID 0x12345678U
#define SHELL_TEST_PEER_ID 0x87654321U

#define SHELL_TEST_LONG_NAME  "Zephyr Test Node"
#define SHELL_TEST_SHORT_NAME "ZTN"

/** The configuration the stack was brought up with. */
extern struct meshtastic_config shell_test_cfg;

/** Bring the stack and the dummy shell backend up. */
void *shell_test_setup(void);

/** Put configuration, radio and captured output back to a known state. */
void shell_test_before(void *fixture);

/** Run one command and return the shell's exit code. */
int shell_run(const char *cmd);

/** Fail unless @p needle shows up in what the last command printed. */
void shell_expect(const char *needle);

/** Wait for the frame a deferred command sends, and decode it. */
void shell_deferred_tx(struct meshtastic_packet *packet, uint8_t *payload, size_t payload_len);

#endif /* MESHTASTIC_TESTS_SHELL_FIXTURE_H_ */
```
