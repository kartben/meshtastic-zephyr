## CMakeLists.txt
```
cmake_minimum_required(VERSION 3.20.0)

find_package(Zephyr REQUIRED HINTS $ENV{ZEPHYR_BASE})
project(meshtastic_module_tests)

include(${CMAKE_CURRENT_SOURCE_DIR}/../common/meshtastic_test.cmake)
meshtastic_test_setup()
meshtastic_test_use_mock_lora()

target_sources(app PRIVATE
  src/modules_fixture.c
  src/fake_sensor.c
  src/telemetry.c
  src/nodeinfo.c
  src/message.c
)
```

## prj.conf
```kconfig
CONFIG_ZTEST=y

CONFIG_SENSOR=y

CONFIG_MESHTASTIC=y
CONFIG_MESHTASTIC_SETTINGS=n
CONFIG_MESHTASTIC_BLE=n
CONFIG_MESHTASTIC_SERIAL=n
CONFIG_MESHTASTIC_SHELL=n
CONFIG_MESHTASTIC_GNSS=n
CONFIG_MESHTASTIC_NODEDB=n
CONFIG_MESHTASTIC_MQTT=n
CONFIG_MESHTASTIC_RELIABLE=n

# The port modules under test. Periodic broadcasts stay off so the only
# transmits a test sees are the ones it triggered.
CONFIG_MESHTASTIC_DEVICE_METRICS=y
CONFIG_MESHTASTIC_DEVICE_METRICS_AUTO_SEND=n
CONFIG_MESHTASTIC_ENVIRONMENT_METRICS=y
CONFIG_MESHTASTIC_ENVIRONMENT_METRICS_AUTO_SEND=n
CONFIG_MESHTASTIC_TELEMETRY_WANT_RESPONSE=y
CONFIG_MESHTASTIC_NODEINFO=y
CONFIG_MESHTASTIC_NODEINFO_AUTO_SEND=n
CONFIG_MESHTASTIC_NODEINFO_PEER_CACHE_SIZE=8
CONFIG_MESHTASTIC_MESSAGE=y

CONFIG_MESHTASTIC_NODE_ID_CUSTOM=y

CONFIG_MAIN_STACK_SIZE=4096
```

## app.overlay
```dts
/*
 * SPDX-License-Identifier: GPL-3.0
 *
 * One fake sensor backs every environment metrics alias so a single node
 * exercises temperature, humidity, pressure, gas and light together.
 */

/ {
	env_sensor: env-sensor {
		compatible = "vnd,fake-sensor";
		status = "okay";
	};

	aliases {
		ambient-temp0 = &env_sensor;
		humidity0 = &env_sensor;
		pressure-sensor = &env_sensor;
		gas-sensor = &env_sensor;
		light-sensor = &env_sensor;
	};
};
```

## dts/bindings/vnd,fake-sensor.yaml
```yaml
# SPDX-License-Identifier: GPL-3.0

description: |
  Test-only sensor whose readings are set from the test code. Backs every
  environment metrics alias so a single node exercises all quantities.

compatible: "vnd,fake-sensor"

include: sensor-device.yaml
```

## src/fake_sensor.c
```c
/* SPDX-FileCopyrightText: Benjamin Cabé <kartben@gmail.com>
 * SPDX-License-Identifier: GPL-3.0
 */

#define DT_DRV_COMPAT vnd_fake_sensor

#include <errno.h>

#include <zephyr/device.h>
#include <zephyr/drivers/sensor.h>

#include "fake_sensor.h"

static struct fake_sensor_values values;
static bool failing;

void fake_sensor_set_values(const struct fake_sensor_values *new_values)
{
	values = *new_values;
}

void fake_sensor_set_failing(bool fail)
{
	failing = fail;
}

static int fake_sensor_sample_fetch(const struct device *dev, enum sensor_channel chan)
{
	ARG_UNUSED(dev);
	ARG_UNUSED(chan);

	return failing ? -EIO : 0;
}

static int fake_sensor_channel_get(const struct device *dev, enum sensor_channel chan,
				   struct sensor_value *val)
{
	double reading;

	ARG_UNUSED(dev);

	switch (chan) {
	case SENSOR_CHAN_AMBIENT_TEMP:
		reading = values.temperature;
		break;
	case SENSOR_CHAN_HUMIDITY:
		reading = values.humidity;
		break;
	case SENSOR_CHAN_PRESS:
		reading = values.pressure;
		break;
	case SENSOR_CHAN_GAS_RES:
		reading = values.gas_resistance;
		break;
	case SENSOR_CHAN_LIGHT:
		reading = values.light;
		break;
	default:
		return -ENOTSUP;
	}

	return sensor_value_from_double(val, reading);
}

static DEVICE_API(sensor, fake_sensor_api) = {
	.sample_fetch = fake_sensor_sample_fetch,
	.channel_get = fake_sensor_channel_get,
};

static int fake_sensor_init(const struct device *dev)
{
	ARG_UNUSED(dev);

	return 0;
}

DEVICE_DT_INST_DEFINE(0, fake_sensor_init, NULL, NULL, NULL, POST_KERNEL,
		      CONFIG_SENSOR_INIT_PRIORITY, &fake_sensor_api);
```

## src/fake_sensor.h
```c
/* SPDX-FileCopyrightText: Benjamin Cabé <kartben@gmail.com>
 * SPDX-License-Identifier: GPL-3.0
 */

/**
 * @file
 * @brief Test-only sensor backing every environment metrics alias.
 */

#ifndef MESHTASTIC_TESTS_FAKE_SENSOR_H_
#define MESHTASTIC_TESTS_FAKE_SENSOR_H_

#include <stdbool.h>

/** Readings the fake sensor reports, in Zephyr's units. */
struct fake_sensor_values {
	/** Ambient temperature, degrees Celsius. */
	double temperature;
	/** Relative humidity, percent. */
	double humidity;
	/** Barometric pressure, kPa. */
	double pressure;
	/** Gas resistance, ohms. */
	double gas_resistance;
	/** Illuminance, lux. */
	double light;
};

/** Replace the readings the sensor reports. */
void fake_sensor_set_values(const struct fake_sensor_values *values);

/** Make every sample fetch fail, as an absent or broken sensor would. */
void fake_sensor_set_failing(bool failing);

#endif /* MESHTASTIC_TESTS_FAKE_SENSOR_H_ */
```

## src/message.c
```c
/* SPDX-FileCopyrightText: Benjamin Cabé <kartben@gmail.com>
 * SPDX-License-Identifier: GPL-3.0
 */

#include <string.h>

#include <zephyr/kernel.h>
#include <zephyr/ztest.h>

#include <zephyr/meshtastic/meshtastic.h>

#include "meshtastic_modules.h"

#include "modules_fixture.h"

#define PEER_NODE_ID  0xC0000001U
#define OTHER_NODE_ID 0xC0000002U

static const char text[] = "hello mesh";

static struct meshtastic_packet text_packet(uint32_t from, uint32_t to)
{
	struct meshtastic_packet packet = {
		.from = from,
		.to = to,
		.id = 0x77U,
		.portnum = MESHTASTIC_PORT_TEXT_MESSAGE,
		.payload = (const uint8_t *)text,
		.payload_len = strlen(text),
		.channel_index = MESHTASTIC_CHANNEL_INDEX_INVALID,
	};

	return packet;
}

static void before(void *fixture)
{
	ARG_UNUSED(fixture);
	modules_reset();
}

ZTEST_SUITE(text_message, NULL, modules_suite_setup, before, NULL, NULL);

ZTEST(text_message, test_a_direct_message_raises_a_text_event)
{
	struct meshtastic_packet packet = text_packet(PEER_NODE_ID, TEST_NODE_ID);
	struct meshtastic_packet received;
	uint8_t payload[MESHTASTIC_MAX_PAYLOAD_LEN];
	struct meshtastic_event event;

	meshtastic_dispatch_modules(&packet);

	zassert_true(modules_last_event(&event, &received, payload, sizeof(payload)));
	zassert_equal(event.type, MESHTASTIC_EVENT_TEXT_MESSAGE);
	zassert_equal(received.from, PEER_NODE_ID);
	zassert_equal(received.payload_len, strlen(text));
	zassert_mem_equal(payload, text, strlen(text));
}

ZTEST(text_message, test_a_broadcast_message_raises_a_text_event)
{
	struct meshtastic_packet packet = text_packet(PEER_NODE_ID, MESHTASTIC_NODE_BROADCAST);
	struct meshtastic_event event;

	meshtastic_dispatch_modules(&packet);

	zassert_true(modules_last_event(&event, NULL, NULL, 0U));
	zassert_equal(event.type, MESHTASTIC_EVENT_TEXT_MESSAGE);
}

ZTEST(text_message, test_messages_for_other_nodes_are_not_delivered_locally)
{
	struct meshtastic_packet packet = text_packet(PEER_NODE_ID, OTHER_NODE_ID);

	meshtastic_dispatch_modules(&packet);

	zassert_equal(modules_event_count(), 0U);
}

ZTEST(text_message, test_our_own_and_empty_messages_are_ignored)
{
	struct meshtastic_packet packet = text_packet(TEST_NODE_ID, TEST_NODE_ID);

	meshtastic_dispatch_modules(&packet);

	packet.from = 0U;
	meshtastic_dispatch_modules(&packet);

	packet.from = PEER_NODE_ID;
	packet.payload = NULL;
	packet.payload_len = 0U;
	meshtastic_dispatch_modules(&packet);

	zassert_equal(modules_event_count(), 0U);
}

ZTEST(text_message, test_other_ports_do_not_raise_a_text_event)
{
	struct meshtastic_packet packet = text_packet(PEER_NODE_ID, TEST_NODE_ID);

	packet.portnum = MESHTASTIC_PORT_PRIVATE;
	meshtastic_dispatch_modules(&packet);

	zassert_equal(modules_event_count(), 0U);
}
```

## src/modules_fixture.c
```c
/* SPDX-FileCopyrightText: Benjamin Cabé <kartben@gmail.com>
 * SPDX-License-Identifier: GPL-3.0
 */

#include <string.h>

#include <zephyr/kernel.h>
#include <zephyr/ztest.h>

#include <pb_encode.h>

#include "meshtastic_core.h"
#include "meshtastic_modules.h"
#include "meshtastic_packet.h"

#include "modules_fixture.h"

static struct {
	struct meshtastic_event event;
	struct meshtastic_packet packet;
	uint8_t payload[MESHTASTIC_MAX_PAYLOAD_LEN];
	size_t payload_len;
	uint32_t count;
} events;

static void on_event(const struct meshtastic_event *event, void *user_data)
{
	ARG_UNUSED(user_data);

	events.event = *event;
	events.payload_len = 0U;
	if (event->packet != NULL) {
		events.packet = *event->packet;
		events.packet.payload = events.payload;
		events.payload_len = event->packet->payload_len;
		memcpy(events.payload, event->packet->payload, events.payload_len);
	} else {
		memset(&events.packet, 0, sizeof(events.packet));
	}
	events.count++;
}

void *modules_suite_setup(void)
{
	static struct meshtastic_config cfg = {
		.node_id = TEST_NODE_ID,
		.psk = meshtastic_default_psk,
		.psk_len = sizeof(meshtastic_default_psk),
		.channel_name = MESHTASTIC_CHANNEL_LONGFAST,
		.frequency = MESHTASTIC_FREQ_EU,
		.long_name = "Zephyr Test Node",
		.short_name = "ZTN",
	};
	static bool initialized;

	if (!initialized) {
		cfg.lora_dev = mock_lora_device();
		zassert_ok(meshtastic_init(&cfg), "meshtastic_init failed");
		meshtastic_set_event_cb(on_event, NULL);
		initialized = true;
	}

	return NULL;
}

void modules_reset(void)
{
	mock_lora_reset();
	memset(&events, 0, sizeof(events));
}

uint32_t modules_event_count(void)
{
	return events.count;
}

bool modules_last_event(struct meshtastic_event *event, struct meshtastic_packet *packet,
			uint8_t *payload, size_t payload_len)
{
	if (events.count == 0U) {
		return false;
	}

	*event = events.event;
	if (packet != NULL) {
		*packet = events.packet;
		packet->payload = payload;
	}
	if (payload != NULL) {
		zassert_true(events.payload_len <= payload_len, "event payload buffer too small");
		memcpy(payload, events.payload, events.payload_len);
	}

	return true;
}

void modules_introduce_peer(uint32_t node)
{
	meshtastic_User user = meshtastic_User_init_zero;
	uint8_t payload[MESHTASTIC_MAX_PAYLOAD_LEN];
	pb_ostream_t stream = pb_ostream_from_buffer(payload, sizeof(payload));
	struct meshtastic_packet packet = {
		.from = node,
		.to = MESHTASTIC_NODE_BROADCAST,
		.id = node,
		.portnum = MESHTASTIC_PORT_NODEINFO,
		.payload = payload,
		.channel_index = MESHTASTIC_CHANNEL_INDEX_INVALID,
	};

	snprintk(user.id, sizeof(user.id), "!%08x", node);
	strcpy(user.long_name, "Peer");
	strcpy(user.short_name, "PR");

	zassert_true(pb_encode(&stream, meshtastic_User_fields, &user), "User encode failed");
	packet.payload_len = stream.bytes_written;

	meshtastic_dispatch_modules(&packet);
}

void modules_decode_tx(uint32_t expected, struct meshtastic_packet *packet, uint8_t *payload,
		       size_t payload_len)
{
	uint8_t wire[MESHTASTIC_PKT_MAX];
	uint32_t wire_len;

	zassert_true(mock_lora_wait_for_send_count(expected, K_MSEC(500)),
		     "the radio did not transmit in time");
	zassert_equal(mock_lora_send_count(), expected, "unexpected lora_send count");

	wire_len = mock_lora_last_tx(wire, sizeof(wire));
	zassert_ok(meshtastic_decode_wire_packet(wire, (int)wire_len, 0, 0, packet, payload,
						 payload_len),
		   "could not decode the transmitted frame");
}
```

## src/modules_fixture.h
```c
/* SPDX-FileCopyrightText: Benjamin Cabé <kartben@gmail.com>
 * SPDX-License-Identifier: GPL-3.0
 */

/**
 * @file
 * @brief Shared bring-up and helpers for the port module suites.
 */

#ifndef MESHTASTIC_TESTS_MODULES_FIXTURE_H_
#define MESHTASTIC_TESTS_MODULES_FIXTURE_H_

#include <stdbool.h>
#include <stddef.h>
#include <stdint.h>

#include <zephyr/meshtastic/meshtastic.h>

#include "mock_lora.h"

#define TEST_NODE_ID 0x12345678U

/** Bring the stack up once on the mock radio; usable as a ztest suite setup. */
void *modules_suite_setup(void);

/** Forget the recorded transmits and events. */
void modules_reset(void);

/**
 * @brief Introduce @p node to the stack by delivering its NodeInfo.
 *
 * Peers the stack has never heard of are probed for their identity, which
 * would otherwise show up as an extra transmit in unrelated tests.
 */
void modules_introduce_peer(uint32_t node);

/** Number of stack events seen since the last reset. */
uint32_t modules_event_count(void);

/** Copy the most recent stack event, returning false when none was raised. */
bool modules_last_event(struct meshtastic_event *event, struct meshtastic_packet *packet,
			uint8_t *payload, size_t payload_len);

/**
 * @brief Wait for one transmit and decode it back into a packet.
 *
 * Fails the test if the radio was not handed exactly @p expected frames.
 */
void modules_decode_tx(uint32_t expected, struct meshtastic_packet *packet, uint8_t *payload,
		       size_t payload_len);

#endif /* MESHTASTIC_TESTS_MODULES_FIXTURE_H_ */
```

## src/nodeinfo.c
```c
/* SPDX-FileCopyrightText: Benjamin Cabé <kartben@gmail.com>
 * SPDX-License-Identifier: GPL-3.0
 */

#include <string.h>

#include <zephyr/kernel.h>
#include <zephyr/ztest.h>

#include <pb_decode.h>
#include <pb_encode.h>

#include <zephyr/meshtastic/meshtastic.h>
#include <zephyr/meshtastic/nodeinfo.h>

#include "meshtastic_modules.h"

#include "modules_fixture.h"

/* Fresh peers per test: the peer cache is not resettable. */
#define REQUEST_PEER    0xB0000001U
#define SUPPRESSED_PEER 0xB0000002U
#define UNKNOWN_PEER    0xB0000003U
#define KNOWN_PEER      0xB0000004U

static uint8_t tx_payload[MESHTASTIC_MAX_PAYLOAD_LEN];

static meshtastic_User decode_user(const struct meshtastic_packet *packet)
{
	meshtastic_User user = meshtastic_User_init_zero;
	pb_istream_t stream = pb_istream_from_buffer(packet->payload, packet->payload_len);

	zassert_true(pb_decode(&stream, meshtastic_User_fields, &user), "User decode failed");

	return user;
}

static struct meshtastic_packet text_from(uint32_t from)
{
	struct meshtastic_packet packet = {
		.from = from,
		.to = MESHTASTIC_NODE_BROADCAST,
		.id = from,
		.portnum = MESHTASTIC_PORT_TEXT_MESSAGE,
		.payload = (const uint8_t *)"hi",
		.payload_len = 2U,
		.channel_index = MESHTASTIC_CHANNEL_INDEX_INVALID,
	};

	return packet;
}

static void before(void *fixture)
{
	ARG_UNUSED(fixture);
	modules_reset();
}

ZTEST_SUITE(nodeinfo, NULL, modules_suite_setup, before, NULL, NULL);

ZTEST(nodeinfo, test_sending_node_info_broadcasts_our_user)
{
	struct meshtastic_packet sent;
	meshtastic_User user;

	zassert_ok(meshtastic_send_node_info(MESHTASTIC_NODE_BROADCAST));

	modules_decode_tx(1U, &sent, tx_payload, sizeof(tx_payload));
	zassert_equal(sent.portnum, MESHTASTIC_PORT_NODEINFO);
	zassert_equal(sent.to, MESHTASTIC_NODE_BROADCAST);
	zassert_false(sent.want_response);

	user = decode_user(&sent);
	zassert_str_equal(user.id, "!12345678");
	zassert_str_equal(user.long_name, "Zephyr Test Node");
	zassert_str_equal(user.short_name, "ZTN");
	/* Upstream derives the node number from the low four bytes of macaddr. */
	zassert_equal(user.macaddr[2], 0x12U);
	zassert_equal(user.macaddr[5], 0x78U);
}

ZTEST(nodeinfo, test_a_request_is_answered_with_our_user)
{
	struct meshtastic_packet request = {
		.from = REQUEST_PEER,
		.to = TEST_NODE_ID,
		.id = 0x5150U,
		.portnum = MESHTASTIC_PORT_NODEINFO,
		.channel_index = MESHTASTIC_CHANNEL_INDEX_INVALID,
		.want_response = true,
	};
	struct meshtastic_packet reply;

	meshtastic_dispatch_modules(&request);

	modules_decode_tx(1U, &reply, tx_payload, sizeof(tx_payload));
	zassert_equal(reply.to, REQUEST_PEER);
	zassert_equal(reply.portnum, MESHTASTIC_PORT_NODEINFO);
	zassert_equal(reply.request_id, 0x5150U);
	zassert_false(reply.want_response);
	zassert_str_equal(decode_user(&reply).short_name, "ZTN");
}

ZTEST(nodeinfo, test_a_repeated_request_is_suppressed)
{
	struct meshtastic_packet request = {
		.from = SUPPRESSED_PEER,
		.to = TEST_NODE_ID,
		.id = 1U,
		.portnum = MESHTASTIC_PORT_NODEINFO,
		.channel_index = MESHTASTIC_CHANNEL_INDEX_INVALID,
		.want_response = true,
	};

	meshtastic_dispatch_modules(&request);
	zassert_true(mock_lora_wait_for_send_count(1U, K_MSEC(500)),
		     "the radio did not transmit in time");

	request.id++;
	meshtastic_dispatch_modules(&request);
	k_msleep(100);

	zassert_equal(mock_lora_send_count(), 1U);
}

ZTEST(nodeinfo, test_an_unknown_peer_is_asked_for_its_node_info)
{
	struct meshtastic_packet text = text_from(UNKNOWN_PEER);
	struct meshtastic_packet request;

	meshtastic_dispatch_modules(&text);

	modules_decode_tx(1U, &request, tx_payload, sizeof(tx_payload));
	zassert_equal(request.to, UNKNOWN_PEER);
	zassert_equal(request.portnum, MESHTASTIC_PORT_NODEINFO);
	zassert_true(request.want_response, "the probe must ask the peer to answer");
}

ZTEST(nodeinfo, test_a_peer_that_already_introduced_itself_is_not_probed)
{
	struct meshtastic_packet text = text_from(KNOWN_PEER);

	modules_introduce_peer(KNOWN_PEER);
	k_msleep(100);
	zassert_equal(mock_lora_send_count(), 0U, "a NodeInfo broadcast needs no answer");

	meshtastic_dispatch_modules(&text);
	k_msleep(100);
	zassert_equal(mock_lora_send_count(), 0U);
}

ZTEST(nodeinfo, test_our_own_packets_never_trigger_a_probe)
{
	struct meshtastic_packet text = text_from(TEST_NODE_ID);

	meshtastic_dispatch_modules(&text);

	text.from = 0U;
	meshtastic_dispatch_modules(&text);
	k_msleep(100);

	zassert_equal(mock_lora_send_count(), 0U);
}
```

## src/telemetry.c
```c
/* SPDX-FileCopyrightText: Benjamin Cabé <kartben@gmail.com>
 * SPDX-License-Identifier: GPL-3.0
 */

#include <string.h>

#include <zephyr/kernel.h>
#include <zephyr/ztest.h>

#include <pb_decode.h>
#include <pb_encode.h>

#include <zephyr/meshtastic/meshtastic.h>
#include <zephyr/meshtastic/telemetry.h>

#include "meshtastic_modules.h"
#include "meshtastic_telemetry_internal.h"

#include "fake_sensor.h"
#include "modules_fixture.h"

/* Collection helpers are declared privately by the stack. */
int meshtastic_collect_device_metrics(meshtastic_DeviceMetrics *metrics);
int meshtastic_collect_environment(meshtastic_EnvironmentMetrics *metrics);

/* Fresh peers per test: the reply-suppression tables are not resettable. */
#define METRICS_PEER     0xA0000001U
#define SUPPRESSED_PEER  0xA0000002U
#define ENVIRONMENT_PEER 0xA0000003U
#define BROADCAST_PEER   0xA0000004U
#define NO_SENSOR_PEER   0xA0000005U

static const struct fake_sensor_values readings = {
	.temperature = 21.5,      /* deg C */
	.humidity = 48.0,         /* %RH */
	.pressure = 101.3,        /* kPa */
	.gas_resistance = 250000, /* ohm */
	.light = 830.0,           /* lux */
};

static uint8_t request_payload[MESHTASTIC_MAX_PAYLOAD_LEN];
static uint8_t reply_payload[MESHTASTIC_MAX_PAYLOAD_LEN];

static struct meshtastic_packet telemetry_request(uint32_t from, uint32_t to,
						  const meshtastic_Telemetry *request)
{
	struct meshtastic_packet packet = {
		.from = from,
		.to = to,
		.id = from,
		.portnum = MESHTASTIC_PORT_TELEMETRY,
		.channel_index = MESHTASTIC_CHANNEL_INDEX_INVALID,
		.want_response = true,
	};
	pb_ostream_t stream;

	if (request != NULL) {
		stream = pb_ostream_from_buffer(request_payload, sizeof(request_payload));
		zassert_true(pb_encode(&stream, meshtastic_Telemetry_fields, request),
			     "Telemetry encode failed");
		packet.payload = request_payload;
		packet.payload_len = stream.bytes_written;
	}

	return packet;
}

static meshtastic_Telemetry decode_telemetry(const struct meshtastic_packet *packet)
{
	meshtastic_Telemetry telemetry = meshtastic_Telemetry_init_zero;
	pb_istream_t stream = pb_istream_from_buffer(packet->payload, packet->payload_len);

	zassert_true(pb_decode(&stream, meshtastic_Telemetry_fields, &telemetry),
		     "Telemetry decode failed");

	return telemetry;
}

/* Telemetry senders are known peers; an unknown one would also be probed. */
static void introduce(uint32_t node)
{
	modules_introduce_peer(node);
	k_msleep(50);
	modules_reset();
}

static void before(void *fixture)
{
	ARG_UNUSED(fixture);

	fake_sensor_set_values(&readings);
	fake_sensor_set_failing(false);
	modules_reset();
}

ZTEST_SUITE(telemetry, NULL, modules_suite_setup, before, NULL, NULL);

ZTEST(telemetry, test_device_metrics_always_report_uptime)
{
	meshtastic_DeviceMetrics metrics;

	zassert_ok(meshtastic_collect_device_metrics(&metrics));
	zassert_true(metrics.has_uptime_seconds);
	zassert_equal(meshtastic_collect_device_metrics(NULL), -EINVAL);
}

ZTEST(telemetry, test_sending_device_metrics_transmits_a_telemetry_packet)
{
	struct meshtastic_packet sent;
	meshtastic_Telemetry telemetry;

	zassert_ok(meshtastic_send_device_metrics(MESHTASTIC_NODE_BROADCAST, K_FOREVER));

	modules_decode_tx(1U, &sent, reply_payload, sizeof(reply_payload));
	zassert_equal(sent.portnum, MESHTASTIC_PORT_TELEMETRY);
	zassert_equal(sent.to, MESHTASTIC_NODE_BROADCAST);

	telemetry = decode_telemetry(&sent);
	zassert_equal(telemetry.which_variant, meshtastic_Telemetry_device_metrics_tag);
	zassert_true(telemetry.variant.device_metrics.has_uptime_seconds);
}

ZTEST(telemetry, test_a_request_is_answered_with_device_metrics)
{
	struct meshtastic_packet request = telemetry_request(METRICS_PEER, TEST_NODE_ID, NULL);
	struct meshtastic_packet reply;
	meshtastic_Telemetry telemetry;

	introduce(METRICS_PEER);
	meshtastic_dispatch_modules(&request);

	modules_decode_tx(1U, &reply, reply_payload, sizeof(reply_payload));
	zassert_equal(reply.to, METRICS_PEER);
	zassert_equal(reply.portnum, MESHTASTIC_PORT_TELEMETRY);
	zassert_equal(reply.request_id, request.id, "the reply must correlate with the request");
	zassert_false(reply.want_response, "a reply must not ask for another reply");

	telemetry = decode_telemetry(&reply);
	zassert_equal(telemetry.which_variant, meshtastic_Telemetry_device_metrics_tag);
}

ZTEST(telemetry, test_a_repeated_request_is_suppressed)
{
	struct meshtastic_packet request = telemetry_request(SUPPRESSED_PEER, TEST_NODE_ID, NULL);

	introduce(SUPPRESSED_PEER);
	meshtastic_dispatch_modules(&request);
	zassert_true(mock_lora_wait_for_send_count(1U, K_MSEC(500)),
		     "the radio did not transmit in time");

	request.id++;
	meshtastic_dispatch_modules(&request);
	k_msleep(100);

	zassert_equal(mock_lora_send_count(), 1U,
		      "a second request inside the suppression window must be ignored");
}

ZTEST(telemetry, test_an_environment_request_is_answered_with_sensor_readings)
{
	meshtastic_Telemetry request = meshtastic_Telemetry_init_zero;
	struct meshtastic_packet packet;
	struct meshtastic_packet reply;
	meshtastic_Telemetry telemetry;

	request.which_variant = meshtastic_Telemetry_environment_metrics_tag;
	packet = telemetry_request(ENVIRONMENT_PEER, TEST_NODE_ID, &request);

	introduce(ENVIRONMENT_PEER);
	meshtastic_dispatch_modules(&packet);

	modules_decode_tx(1U, &reply, reply_payload, sizeof(reply_payload));
	telemetry = decode_telemetry(&reply);
	zassert_equal(telemetry.which_variant, meshtastic_Telemetry_environment_metrics_tag);
	zassert_within(telemetry.variant.environment_metrics.temperature, 21.5f, 0.01f);
}

ZTEST(telemetry, test_an_environment_request_is_ignored_when_the_sensor_fails)
{
	meshtastic_Telemetry request = meshtastic_Telemetry_init_zero;
	struct meshtastic_packet packet;

	fake_sensor_set_failing(true);
	request.which_variant = meshtastic_Telemetry_environment_metrics_tag;
	packet = telemetry_request(NO_SENSOR_PEER, TEST_NODE_ID, &request);

	introduce(NO_SENSOR_PEER);
	meshtastic_dispatch_modules(&packet);
	k_msleep(100);

	zassert_equal(mock_lora_send_count(), 0U);
}

ZTEST(telemetry, test_broadcast_and_local_requests_are_not_answered)
{
	struct meshtastic_packet broadcast =
		telemetry_request(BROADCAST_PEER, MESHTASTIC_NODE_BROADCAST, NULL);
	struct meshtastic_packet loopback = telemetry_request(TEST_NODE_ID, TEST_NODE_ID, NULL);

	introduce(BROADCAST_PEER);
	meshtastic_dispatch_modules(&broadcast);
	meshtastic_dispatch_modules(&loopback);
	k_msleep(100);

	zassert_equal(mock_lora_send_count(), 0U);
}

ZTEST(telemetry, test_environment_metrics_are_converted_to_meshtastic_units)
{
	meshtastic_EnvironmentMetrics metrics;

	zassert_equal(meshtastic_collect_environment(&metrics), 5, "expected five readings");
	zassert_true(metrics.has_temperature);
	zassert_within(metrics.temperature, 21.5f, 0.01f);
	zassert_true(metrics.has_relative_humidity);
	zassert_within(metrics.relative_humidity, 48.0f, 0.01f);
	/* Zephyr reports kPa, the Meshtastic field is hPa. */
	zassert_true(metrics.has_barometric_pressure);
	zassert_within(metrics.barometric_pressure, 1013.0f, 0.1f);
	/* Zephyr reports ohms, the Meshtastic field is MOhm. */
	zassert_true(metrics.has_gas_resistance);
	zassert_within(metrics.gas_resistance, 0.25f, 0.001f);
	zassert_true(metrics.has_lux);
	zassert_within(metrics.lux, 830.0f, 0.1f);

	zassert_equal(meshtastic_collect_environment(NULL), -EINVAL);
}

ZTEST(telemetry, test_sending_environment_metrics_transmits_a_telemetry_packet)
{
	struct meshtastic_packet sent;

	zassert_ok(meshtastic_send_environment(MESHTASTIC_NODE_BROADCAST, K_FOREVER));

	modules_decode_tx(1U, &sent, reply_payload, sizeof(reply_payload));
	zassert_equal(decode_telemetry(&sent).which_variant,
		      meshtastic_Telemetry_environment_metrics_tag);
}

ZTEST(telemetry, test_a_failing_sensor_reports_a_metrics_error)
{
	meshtastic_EnvironmentMetrics metrics;
	struct meshtastic_event event;

	fake_sensor_set_failing(true);

	zassert_equal(meshtastic_collect_environment(&metrics), -ENODEV);
	zassert_equal(meshtastic_send_environment(MESHTASTIC_NODE_BROADCAST, K_NO_WAIT), -ENODEV);
	zassert_true(modules_last_event(&event, NULL, NULL, 0U));
	zassert_equal(event.type, MESHTASTIC_EVENT_METRICS_ERROR);
	zassert_equal(event.err, -ENODEV);
}

ZTEST(telemetry, test_an_empty_request_payload_decodes_as_an_unset_variant)
{
	meshtastic_Telemetry request;
	struct meshtastic_packet packet = {0};
	const uint8_t garbage[] = {0xFFU, 0xFFU, 0xFFU};

	zassert_true(meshtastic_telemetry_decode_request(NULL, &request));
	zassert_equal(request.which_variant, 0U);

	zassert_true(meshtastic_telemetry_decode_request(&packet, &request));
	zassert_equal(request.which_variant, 0U);

	zassert_false(meshtastic_telemetry_decode_request(&packet, NULL));

	packet.payload = garbage;
	packet.payload_len = sizeof(garbage);
	zassert_false(meshtastic_telemetry_decode_request(&packet, &request));
}

ZTEST(telemetry, test_encoding_a_reply_validates_its_arguments)
{
	meshtastic_Telemetry telemetry = meshtastic_Telemetry_init_zero;
	struct meshtastic_packet packet;

	zassert_equal(meshtastic_telemetry_encode_packet(0U, 0U, 0U, NULL, reply_payload, &packet),
		      -EINVAL);
	zassert_equal(meshtastic_telemetry_encode_packet(0U, 0U, 0U, &telemetry, NULL, &packet),
		      -EINVAL);
	zassert_equal(
		meshtastic_telemetry_encode_packet(0U, 0U, 0U, &telemetry, reply_payload, NULL),
		-EINVAL);
}
```
