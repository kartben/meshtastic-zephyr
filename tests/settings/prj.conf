## CMakeLists.txt
```
cmake_minimum_required(VERSION 3.20.0)

find_package(Zephyr REQUIRED HINTS $ENV{ZEPHYR_BASE})
project(meshtastic_settings_tests)

include(${CMAKE_CURRENT_SOURCE_DIR}/../common/meshtastic_test.cmake)
meshtastic_test_setup()
meshtastic_test_use_mock_lora()

target_sources(app PRIVATE
  src/apply.c
  src/persistence.c
  src/settings_fixture.c
)
```

## prj.conf
```kconfig
CONFIG_ZTEST=y

CONFIG_MESHTASTIC=y
CONFIG_MESHTASTIC_SETTINGS=y
CONFIG_MESHTASTIC_SETTINGS_SAVE_DELAY_MS=100
CONFIG_MESHTASTIC_BLE=n
CONFIG_MESHTASTIC_SERIAL=n
CONFIG_MESHTASTIC_SHELL=n
CONFIG_MESHTASTIC_GNSS=n
CONFIG_MESHTASTIC_DEVICE_METRICS=n
CONFIG_MESHTASTIC_ENVIRONMENT_METRICS=n
CONFIG_MESHTASTIC_NODEDB=n
CONFIG_MESHTASTIC_NODEINFO=n
CONFIG_MESHTASTIC_MESSAGE=n
CONFIG_MESHTASTIC_MQTT=n
CONFIG_MESHTASTIC_RELIABLE=n

# The storage the firmware would use on a real board: NVS in a flash partition,
# here backed by the simulator rather than a chip.
CONFIG_SETTINGS=y
CONFIG_SETTINGS_RUNTIME=y
CONFIG_SETTINGS_NVS=y
CONFIG_NVS=y
CONFIG_FLASH=y
CONFIG_FLASH_MAP=y
CONFIG_FLASH_SIMULATOR=y

CONFIG_MESHTASTIC_NODE_ID_CUSTOM=y

CONFIG_MAIN_STACK_SIZE=4096
CONFIG_ZTEST_STACK_SIZE=4096
```

## src/apply.c
```c
/* SPDX-FileCopyrightText: Benjamin Cabé <kartben@gmail.com>
 * SPDX-License-Identifier: GPL-3.0
 */

/**
 * @file
 * @brief The hooks modules register to react to freshly loaded settings.
 *
 * The hooks below are this test's own. They are linked into the iterable
 * section in symbol-name order, so a_ok runs before c_last.
 */

#include <errno.h>

#include <zephyr/ztest.h>

#include "meshtastic_core.h"

#include "settings_fixture.h"

static int first_result;
static uint32_t first_runs;
static uint32_t last_runs;

static int apply_first(void)
{
	first_runs++;

	return first_result;
}

static int apply_last(void)
{
	last_runs++;

	return 0;
}

MESHTASTIC_SETTINGS_APPLY_DEFINE(a_ok, apply_first);
MESHTASTIC_SETTINGS_APPLY_DEFINE(b_no_callback, NULL);
MESHTASTIC_SETTINGS_APPLY_DEFINE(c_last, apply_last);

static void before(void *fixture)
{
	ARG_UNUSED(fixture);

	first_result = 0;
	first_runs = 0U;
	last_runs = 0U;
}

ZTEST_SUITE(settings_apply, NULL, settings_test_setup, before, NULL, NULL);

ZTEST(settings_apply, test_every_hook_with_a_callback_runs)
{
	zassert_ok(meshtastic_settings_apply_all());

	zassert_equal(first_runs, 1U);
	zassert_equal(last_runs, 1U, "a hook with no callback must not stop the walk");
}

ZTEST(settings_apply, test_a_failing_hook_stops_the_walk)
{
	first_result = -EIO;

	zassert_equal(meshtastic_settings_apply_all(), -EIO);

	zassert_equal(first_runs, 1U);
	zassert_equal(last_runs, 0U, "hooks after a failure must not run");
}
```

## src/persistence.c
```c
/* SPDX-FileCopyrightText: Benjamin Cabé <kartben@gmail.com>
 * SPDX-License-Identifier: GPL-3.0
 */

/**
 * @file
 * @brief What survives a reboot, and what the store refuses to load.
 */

#include <string.h>

#include <zephyr/kernel.h>
#include <zephyr/settings/settings.h>
#include <zephyr/ztest.h>

#include "meshtastic_channels.h"
#include "meshtastic_config_store.h"
#include "meshtastic_settings.h"

#include "settings_fixture.h"

#define SAVE_DELAY K_MSEC(CONFIG_MESHTASTIC_SETTINGS_SAVE_DELAY_MS)

/* Keys the exporter is expected to produce, all under the meshtastic subtree. */
struct exported_keys {
	bool owner;
	bool primary_channel;
	bool lora_config;
};

static void set_channel(uint8_t index, meshtastic_Channel_Role role, const char *name)
{
	meshtastic_Channel channel = *meshtastic_channels_get(index);

	channel.role = role;
	channel.has_settings = true;
	strncpy(channel.settings.name, name, sizeof(channel.settings.name) - 1U);

	zassert_ok(meshtastic_config_store_set_channel(index, &channel));
}

static const char *stored_channel_name(uint8_t index)
{
	static meshtastic_Channel channel;

	zassert_ok(meshtastic_config_store_get_channel(index, &channel));

	return channel.settings.name;
}

static meshtastic_Config_DeviceConfig_Role stored_device_role(void)
{
	meshtastic_Config config;

	zassert_ok(meshtastic_config_store_get_config(meshtastic_Config_device_tag, &config));

	return config.payload_variant.device.role;
}

static int note_exported_key(const char *key, size_t len, settings_read_cb read_cb, void *cb_arg,
			     void *param)
{
	struct exported_keys *seen = param;

	ARG_UNUSED(len);
	ARG_UNUSED(read_cb);
	ARG_UNUSED(cb_arg);

	seen->owner |= strcmp(key, "owner") == 0;
	seen->primary_channel |= strcmp(key, "channel/0") == 0;
	seen->lora_config |= strcmp(key, "config/lora") == 0;

	return 0;
}

static void before(void *fixture)
{
	ARG_UNUSED(fixture);

	set_channel(0U, meshtastic_Channel_Role_PRIMARY, MESHTASTIC_CHANNEL_LONGFAST);
	zassert_ok(meshtastic_settings_flush());
}

ZTEST_SUITE(settings_persistence, NULL, settings_test_setup, before, NULL, NULL);

ZTEST(settings_persistence, test_a_saved_channel_comes_back_after_a_reload)
{
	set_channel(0U, meshtastic_Channel_Role_PRIMARY, "Persisted");
	zassert_ok(meshtastic_settings_flush());

	settings_test_forget_ram();
	zassert_str_equal(stored_channel_name(0U), MESHTASTIC_CHANNEL_LONGFAST,
			  "the store should be back to its defaults before the reload");

	settings_test_reload();

	zassert_str_equal(stored_channel_name(0U), "Persisted");
}

ZTEST(settings_persistence, test_a_saved_config_comes_back_after_a_reload)
{
	zassert_ok(meshtastic_config_store_set_device_role(
		meshtastic_Config_DeviceConfig_Role_ROUTER));
	zassert_ok(meshtastic_settings_flush());

	settings_test_forget_ram();
	zassert_equal(stored_device_role(), meshtastic_Config_DeviceConfig_Role_CLIENT);

	settings_test_reload();

	zassert_equal(stored_device_role(), meshtastic_Config_DeviceConfig_Role_ROUTER);
}

ZTEST(settings_persistence, test_a_change_is_saved_once_the_delay_has_passed)
{
	/* Changing configuration schedules the save; nothing else asks for it. */
	set_channel(0U, meshtastic_Channel_Role_PRIMARY, "Coalesced");

	k_sleep(SAVE_DELAY);
	k_sleep(K_MSEC(50));

	settings_test_forget_ram();
	settings_test_reload();

	zassert_str_equal(stored_channel_name(0U), "Coalesced");
}

ZTEST(settings_persistence, test_settings_are_stored_under_the_meshtastic_subtree)
{
	struct exported_keys seen = {0};

	zassert_ok(settings_load_subtree_direct("meshtastic", note_exported_key, &seen));

	zassert_true(seen.owner, "owner was not exported");
	zassert_true(seen.primary_channel, "channel/0 was not exported");
	zassert_true(seen.lora_config, "config/lora was not exported");
}

ZTEST(settings_persistence, test_an_oversized_record_is_ignored)
{
	uint8_t oversized[MESHTASTIC_STORE_VALUE_MAX + 1] = {0};

	zassert_ok(settings_save_one("meshtastic/channel/0", oversized, sizeof(oversized)));

	settings_test_reload();

	zassert_str_equal(stored_channel_name(0U), MESHTASTIC_CHANNEL_LONGFAST,
			  "an unreadable record must not overwrite what is in memory");

	zassert_ok(settings_delete("meshtastic/channel/0"));
}

ZTEST(settings_persistence, test_a_record_the_store_cannot_parse_is_ignored)
{
	const uint8_t nonsense[] = {0xFFU, 0xFFU, 0xFFU, 0xFFU};

	set_channel(1U, meshtastic_Channel_Role_SECONDARY, "Backup");
	zassert_ok(settings_save_one("meshtastic/channel/1", nonsense, sizeof(nonsense)));

	settings_test_reload();

	zassert_str_equal(stored_channel_name(1U), "Backup",
			  "an unparseable record must not overwrite what is in memory");

	zassert_ok(settings_delete("meshtastic/channel/1"));
}

ZTEST(settings_persistence, test_an_unknown_key_is_ignored)
{
	const uint8_t value[] = {0x01U};

	zassert_ok(settings_save_one("meshtastic/not/a/setting", value, sizeof(value)));

	settings_test_reload();

	zassert_ok(settings_delete("meshtastic/not/a/setting"));
}

ZTEST(settings_persistence, test_a_stored_value_can_be_read_back_at_runtime)
{
	uint8_t expected[MESHTASTIC_STORE_VALUE_MAX];
	uint8_t actual[MESHTASTIC_STORE_VALUE_MAX];
	int len;

	len = meshtastic_config_store_setting_get("owner", expected, sizeof(expected));
	zassert_true(len > 0, "the store has no owner record");

	zassert_equal(settings_runtime_get("meshtastic/owner", actual, sizeof(actual)), len);
	zassert_mem_equal(actual, expected, (size_t)len);
}
```

## src/settings_fixture.c
```c
/* SPDX-FileCopyrightText: Benjamin Cabé <kartben@gmail.com>
 * SPDX-License-Identifier: GPL-3.0
 */

#include <zephyr/settings/settings.h>
#include <zephyr/ztest.h>

#include "meshtastic_channels.h"
#include "meshtastic_config_store.h"

#include "mock_lora.h"
#include "settings_fixture.h"

struct meshtastic_config settings_test_cfg = {
	.node_id = SETTINGS_TEST_NODE_ID,
	.psk = meshtastic_default_psk,
	.psk_len = sizeof(meshtastic_default_psk),
	.channel_name = MESHTASTIC_CHANNEL_LONGFAST,
	.frequency = MESHTASTIC_FREQ_EU,
};

void *settings_test_setup(void)
{
	static bool started;

	if (!started) {
		settings_test_cfg.lora_dev = mock_lora_device();
		zassert_ok(meshtastic_init(&settings_test_cfg), "meshtastic_init failed");
		started = true;
	}

	return NULL;
}

void settings_test_forget_ram(void)
{
	/* Seeding snapshots live state rather than inventing it, so reset that first. */
	meshtastic_set_device_role(meshtastic_Config_DeviceConfig_Role_CLIENT);
	zassert_ok(meshtastic_channels_init_from_config(&settings_test_cfg));

	zassert_ok(meshtastic_config_store_seed(&settings_test_cfg));
}

void settings_test_reload(void)
{
	zassert_ok(settings_load_subtree("meshtastic"), "settings load failed");
}
```

## src/settings_fixture.h
```c
/* SPDX-FileCopyrightText: Benjamin Cabé <kartben@gmail.com>
 * SPDX-License-Identifier: GPL-3.0
 */

/**
 * @file
 * @brief Shared setup for the settings suites.
 */

#ifndef MESHTASTIC_TESTS_SETTINGS_FIXTURE_H_
#define MESHTASTIC_TESTS_SETTINGS_FIXTURE_H_

#include <zephyr/meshtastic/meshtastic.h>

#define SETTINGS_TEST_NODE_ID 0x12345678U

/** The configuration the stack was brought up with. */
extern struct meshtastic_config settings_test_cfg;

/** Bring the stack up once, storage included. */
void *settings_test_setup(void);

/**
 * @brief Drop everything the store holds and start again from the defaults.
 *
 * Anything that survives this and a settings_load_subtree() came back from
 * storage rather than from memory.
 */
void settings_test_forget_ram(void);

/** Reload the Meshtastic subtree from storage. */
void settings_test_reload(void);

#endif /* MESHTASTIC_TESTS_SETTINGS_FIXTURE_H_ */
```
