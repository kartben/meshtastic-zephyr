## src/Kconfig.mqtt
```kconfig
# Copyright (c) 2026 The Zephyr Project Contributors
# SPDX-License-Identifier: GPL-3.0

menuconfig MESHTASTIC_MQTT
	bool "Meshtastic MQTT gateway bridge"
	depends on NETWORKING && MQTT_LIB && NET_TCP && NET_SOCKETS && DNS_RESOLVER
	select NANOPB_ENABLE_MALLOC
	help
	  Bridge LoRa mesh packets to a Meshtastic-compatible MQTT broker using
	  ServiceEnvelope protobuf on msh/.../2/e/... topics.

	  Requires a network interface (Wi-Fi, Ethernet, etc.) in addition to LoRa.

	  Select NANOPB_ENABLE_MALLOC as ServiceEnvelope is dynamically allocated.

if MESHTASTIC_MQTT

config MESHTASTIC_MQTT_BROKER_HOST
	string "MQTT broker hostname"
	default "mqtt.meshtastic.org"
	help
	  MQTT broker address without port. For the public Meshtastic broker use
	  mqtt.meshtastic.org with the default credentials below.

config MESHTASTIC_MQTT_BROKER_PORT
	int "MQTT broker port"
	default 1883
	range 1 65535

config MESHTASTIC_MQTT_USERNAME
	string "MQTT username"
	default "meshdev"
	help
	  Default meshdev matches the public mqtt.meshtastic.org broker.

config MESHTASTIC_MQTT_PASSWORD
	string "MQTT password"
	default "large4cats"
	help
	  Default large4cats matches the public mqtt.meshtastic.org broker.

config MESHTASTIC_MQTT_ROOT
	string "MQTT root topic prefix"
	default "msh/EU_868"
	help
	  Root topic prefix prepended to /2/e/... paths. Use msh/US or msh/EU_868
	  (or your region) for the public Meshtastic broker.

config MESHTASTIC_MQTT_ENCRYPTION_ENABLED
	bool "Publish encrypted MeshPackets to MQTT"
	default y
	help
	  When enabled, ServiceEnvelope carries encrypted MeshPacket payloads
	  (wire-compatible with official firmware). Downlink rejects decoded
	  packets when this is set.

config MESHTASTIC_MQTT_UPLINK_ENABLED
	bool "Uplink mesh packets to MQTT"
	default y
	help
	  Publish packets heard on LoRa (and locally transmitted) to the broker.

config MESHTASTIC_MQTT_DOWNLINK_ENABLED
	bool "Downlink MQTT packets to mesh"
	default y
	help
	  Subscribe to the channel topic and inject received ServiceEnvelopes
	  onto the local mesh.

config MESHTASTIC_MQTT_IGNORE_MQTT
	bool "Ignore packets that arrived via MQTT"
	default n
	help
	  When enabled, drop LoRa packets that have the via_mqtt flag set
	  (matches config.lora.ignore_mqtt in official firmware).

config MESHTASTIC_MQTT_THREAD_STACK_SIZE
	int "MQTT worker thread stack size"
	default 4096

config MESHTASTIC_MQTT_THREAD_PRIORITY
	int "MQTT worker thread priority"
	default 10
	help
	  Priority for the MQTT broker worker. This should normally be lower
	  priority than LoRa packet processing and local command workers so
	  connected broker I/O cannot delay local mesh sends.

config MESHTASTIC_MQTT_PUBLISH_QUEUE_SIZE
	int "Offline MQTT publish queue depth"
	default 32
	range 4 64
	help
	  Encoded MQTT ServiceEnvelope publishes that cannot be written to the
	  broker immediately are retained here and retried on the MQTT worker
	  thread. When full, the oldest envelope is dropped so newer mesh
	  traffic can continue to make progress.

config MESHTASTIC_MQTT_UPLINK_QUEUE_SIZE
	int "Deferred MQTT uplink encode queue depth"
	default 16
	range 4 64
	depends on MESHTASTIC_MQTT_UPLINK_ENABLED
	help
	  Packets to uplink are queued here and processed on the MQTT thread so
	  LoRa TX/RX and shell commands are not blocked on broker I/O. When
	  full, the newest packet is dropped before any protobuf or broker work
	  is attempted.

config MESHTASTIC_MQTT_RECONNECT_INTERVAL_MS
	int "Reconnect interval when broker is unreachable (ms)"
	default 5000
	range 1000 60000

config MESHTASTIC_MQTT_RX_BUFFER_SIZE
	int "MQTT client RX buffer size"
	default 1024
	range 256 4096

config MESHTASTIC_MQTT_TX_BUFFER_SIZE
	int "MQTT client TX buffer size"
	default 1024
	range 256 4096

config MESHTASTIC_MQTT_MAP_REPORT
	bool "Publish MapReport to MQTT map topic"
	default n
	help
	  Periodically publish an unencrypted MapReport wrapped in a
	  ServiceEnvelope to {root}/2/map/ (compatible with the public Meshtastic
	  map). Requires a position fix when location reporting is enabled.

if MESHTASTIC_MQTT_MAP_REPORT

config MESHTASTIC_MQTT_MAP_REPORT_INTERVAL_SEC
	int "MapReport publish interval (seconds)"
	default 900
	range 60 86400
	help
	  Minimum interval between map reports. Official firmware defaults to
	  15 minutes.

config MESHTASTIC_MQTT_MAP_REPORT_POSITION_PRECISION
	int "MapReport location precision (bits)"
	default 14
	range 12 15
	help
	  Bits of precision for latitude and longitude in the map report.
	  Values outside 12-15 are clamped to the default (14).

endif # MESHTASTIC_MQTT_MAP_REPORT

endif # MESHTASTIC_MQTT
```

## src/Kconfig.nodedb
```kconfig
# Copyright (c) 2026 The Zephyr Project Contributors
# SPDX-License-Identifier: GPL-3.0

menuconfig MESHTASTIC_NODEDB
	bool "Meshtastic in-RAM NodeDB"
	default y
	help
	  Track mesh nodes heard by the Meshtastic subsystem in RAM. This
	  initial implementation is volatile and does not persist entries to
	  flash.

if MESHTASTIC_NODEDB

config MESHTASTIC_NODEDB_MAX_NODES
	int "Maximum NodeDB entries"
	default 16
	range 1 256
	help
	  Maximum number of nodes kept in the in-RAM Meshtastic NodeDB,
	  including the local node entry.

endif # MESHTASTIC_NODEDB
```

## src/Kconfig.nodeinfo
```kconfig
# Copyright (c) 2026 The Zephyr Project Contributors
# SPDX-License-Identifier: GPL-3.0

menuconfig MESHTASTIC_NODEINFO
	bool "Meshtastic NodeInfo announcement"
	default y
	help
	  Announce this node's User identity (name, MAC address derived from
	  the node ID, hardware model and role) to the mesh on the
	  NODEINFO_APP port. Without it peers only see a bare node number
	  with no name, MAC address or hardware model.

if MESHTASTIC_NODEINFO

config MESHTASTIC_NODEINFO_AUTO_SEND
	bool "Automatically broadcast NodeInfo"
	default y
	help
	  Periodically broadcast NodeInfo after meshtastic_init() so peers
	  (including nodes that join later) learn about this node.

config MESHTASTIC_NODEINFO_START_DELAY_SEC
	int "Delay before the first NodeInfo broadcast in seconds"
	default 30
	range 0 3600
	depends on MESHTASTIC_NODEINFO_AUTO_SEND
	help
	  Time to wait after meshtastic_init() before the first NodeInfo
	  broadcast, giving the radio and network time to settle.

config MESHTASTIC_NODEINFO_INTERVAL_SEC
	int "NodeInfo broadcast interval in seconds"
	default 10800
	range 3600 86400
	depends on MESHTASTIC_NODEINFO_AUTO_SEND
	help
	  Interval between automatic NodeInfo broadcasts. The upstream
	  Meshtastic default is 3 hours (10800 s); broadcasting more than
	  once an hour is discouraged to limit channel utilisation.

config MESHTASTIC_NODEINFO_PEER_CACHE_SIZE
	int "NodeInfo peer cache size"
	default 16
	range 4 64
	help
	  Number of peers tracked in RAM for ad-hoc NodeInfo behavior. Peers
	  with known User records do not trigger automatic NodeInfo requests.

config MESHTASTIC_NODEINFO_UNKNOWN_SUPPRESS_SEC
	int "Unknown-peer NodeInfo request suppression interval"
	default 600
	range 60 86400
	help
	  Minimum time before asking the same unknown peer for NodeInfo again.

config MESHTASTIC_NODEINFO_REPLY_SUPPRESS_SEC
	int "NodeInfo response suppression interval"
	default 43200
	range 60 86400
	help
	  Minimum time before replying again to the same peer's NodeInfo
	  want_response request.

endif # MESHTASTIC_NODEINFO
```

## src/Kconfig.serial
```kconfig
# Copyright (c) 2026 The Zephyr Project Contributors
# SPDX-License-Identifier: GPL-3.0

DT_CHOSEN_Z_MESHTASTIC_UART := zephyr,meshtastic-uart

menuconfig MESHTASTIC_SERIAL
	bool "Meshtastic serial PhoneAPI transport"
	depends on SERIAL
	depends on UART_INTERRUPT_DRIVEN
	depends on $(dt_chosen_enabled,$(DT_CHOSEN_Z_MESHTASTIC_UART))
	select MESHTASTIC_PHONEAPI
	help
	  Expose the Meshtastic PhoneAPI on the UART selected by the
	  zephyr,meshtastic-uart devicetree chosen node. The transport uses
	  stock Meshtastic StreamAPI framing, not COBS.

	  Example overlay:

	    / {
	        chosen {
	            zephyr,meshtastic-uart = &uart1;
	        };
	    };

	  Prefer a dedicated UART. If this chosen node points at a console,
	  shell, or logging UART, that output can corrupt phone-app framing.

if MESHTASTIC_SERIAL

config MESHTASTIC_SERIAL_FROMRADIO_QUEUE_SIZE
	int "Serial FromRadio queue depth"
	default 8
	range 8 64
	help
	  Number of encoded FromRadio frames retained for the serial phone
	  client.

config MESHTASTIC_SERIAL_RX_BUF_SIZE
	int "Serial RX ring buffer size"
	default 640
	range 64 4096
	help
	  Number of bytes buffered from the UART ISR before the serial worker
	  decodes StreamAPI frames.

config MESHTASTIC_SERIAL_TX_BUF_SIZE
	int "Serial TX ring buffer size"
	default 2048
	range 256 8192
	help
	  Number of bytes queued for interrupt-driven UART transmission.

config MESHTASTIC_SERIAL_WORK_STACK_SIZE
	int "Serial PhoneAPI work thread stack size"
	default 4096
	help
	  Stack size for deferred frame decoding and ToRadio handling.

config MESHTASTIC_SERIAL_WORK_PRIORITY
	int "Serial PhoneAPI work thread priority"
	default 8
	help
	  Priority for serial PhoneAPI processing.

endif # MESHTASTIC_SERIAL

comment "Meshtastic serial requires /chosen/zephyr,meshtastic-uart"
	depends on SERIAL
	depends on UART_INTERRUPT_DRIVEN
	depends on !$(dt_chosen_enabled,$(DT_CHOSEN_Z_MESHTASTIC_UART))
```

## src/Kconfig.shell
```kconfig
# Copyright (c) 2026 The Zephyr Project Contributors
# SPDX-License-Identifier: GPL-3.0

menuconfig MESHTASTIC_SHELL
	bool "Meshtastic shell commands"
	depends on SHELL
	help
	  Add a "meshtastic" shell command group for status, text send,
	  app-port send, and optional gnss/metrics/environment send
	  subcommands when the corresponding Meshtastic features are enabled.

if MESHTASTIC_SHELL

config MESHTASTIC_SHELL_WORK_STACK_SIZE
	int "Meshtastic shell work thread stack size"
	default 3072
	help
	  Stack size for deferred shell commands that may block on LoRa TX or
	  protobuf encoding.

config MESHTASTIC_SHELL_WORK_PRIORITY
	int "Meshtastic shell work thread priority"
	default 8
	help
	  Priority for deferred Meshtastic shell command handling.

config MESHTASTIC_SHELL_QUEUE_SIZE
	int "Meshtastic shell command queue depth"
	default 4
	range 1 16
	help
	  Number of deferred shell commands that can be queued.

endif # MESHTASTIC_SHELL
```

## src/Kconfig.smp
```kconfig
# Copyright (c) 2026 The Zephyr Project Contributors
# SPDX-License-Identifier: GPL-3.0

menuconfig MESHTASTIC_SMP
	bool "Meshtastic MCUmgr SMP transport"
	depends on MCUMGR
	help
	  Expose Zephyr's MCUmgr Simple Management Protocol over a dedicated
	  Meshtastic application port. Requests are carried as raw SMP packets in
	  Meshtastic payloads and answered with a matching raw SMP response.

	  This transport is best suited to small request/response commands such as
	  OS echo or basic info retrieval. Meshtastic payload size limits mean
	  large responses and image management uploads are not supported.

if MESHTASTIC_SMP

config MESHTASTIC_SMP_PORTNUM
	int "Meshtastic application port used for SMP"
	default 256
	range 64 511
	help
	  Meshtastic application port number used to carry raw SMP request and
	  response payloads. Use a registered 3rd-party application port or one
	  of the private application ports (256-511).

endif # MESHTASTIC_SMP
```

## src/Kconfig.telemetry
```kconfig
# Copyright (c) 2026 The Zephyr Project Contributors
# SPDX-License-Identifier: GPL-3.0

menuconfig MESHTASTIC_TELEMETRY_WANT_RESPONSE
	bool "Reply to incoming telemetry want_response requests"
	default y
	depends on MESHTASTIC_DEVICE_METRICS || MESHTASTIC_ENVIRONMENT_METRICS
	help
	  Register port-67 alloc_reply handlers in the device-metrics and
	  environment-metrics modules (matching upstream DeviceTelemetryModule
	  and EnvironmentTelemetryModule on TELEMETRY_APP).

if MESHTASTIC_TELEMETRY_WANT_RESPONSE

config MESHTASTIC_TELEMETRY_REPLY_SUPPRESS_SEC
	int "Minimum seconds between telemetry want_response replies per peer"
	default 180
	range 0 86400
	help
	  Rate-limit responses to incoming Telemetry requests with
	  want_response set.

endif # MESHTASTIC_TELEMETRY_WANT_RESPONSE
```

## tests/protocol/testcase.yaml
```yaml
common:
  tags:
    - meshtastic
    - protocol
    - native_sim
  integration_platforms:
    - native_sim/native/64
  platform_allow:
    - native_sim/native/64
tests:
  meshtastic.protocol.native_sim: {}
```

## west.yml
```yaml
# SPDX-License-Identifier: Apache-2.0

manifest:
  remotes:
    - name: zephyrproject-rtos
      url-base: https://github.com/zephyrproject-rtos

  projects:
    - name: zephyr
      remote: zephyrproject-rtos
      revision: main
      clone-depth: 1
      import:
        name-allowlist:
          - cmsis
          - cmsis_6
          - hal_espressif
          - hal_stm32
          - hal_xtensa
          - mbedtls
          - tf-psa-crypto
          - nanopb
          - picolibc
          - loramac-node # drop me eventually, not used but there's a kconfig issue preventing
                         # build when HAS_SEMTECH_SX126X=y but module is not present, even when
                         # using native lora backend
```
