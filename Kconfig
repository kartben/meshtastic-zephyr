## samples/meshtastic/boards/arduino_giga_r1_stm32h747xx_m7.conf
```kconfig
CONFIG_MESHTASTIC_NODE_LONG_NAME="Arduino GIGA R1"
CONFIG_MESHTASTIC_NODE_SHORT_NAME="GIGA"
```

## samples/meshtastic/boards/twatch_s3_esp32s3_procpu.conf
```kconfig
CONFIG_MESHTASTIC_NODE_LONG_NAME="T-Watch S3"
CONFIG_MESHTASTIC_NODE_SHORT_NAME="TWS3"

CONFIG_I2C=y
CONFIG_REGULATOR=y
CONFIG_FUEL_GAUGE=y

CONFIG_MESHTASTIC_FUEL_GAUGE=y
CONFIG_MESHTASTIC_TX_POWER=4
```

## src/Kconfig
```kconfig
# Meshtastic mesh radio stack
#
# Copyright (c) 2026 The Zephyr Project Contributors
# SPDX-License-Identifier: GPL-3.0

menuconfig MESHTASTIC
	bool "Meshtastic mesh radio stack [EXPERIMENTAL]"
	depends on ZEPHYR_NANOPB_MODULE
	select LORA
	select NANOPB
	select PSA_CRYPTO
	select PSA_WANT_ALG_CTR
	select PSA_WANT_KEY_TYPE_AES
	select EXPERIMENTAL
	help
	  Enable the Meshtastic mesh radio stack.

	  Provides a wire-compatible implementation of the Meshtastic protocol
	  (https://meshtastic.org) on top of the Zephyr raw LoRa driver API.
	  Supports text messaging (PortNum 1) and raw data delivery over the
	  LongFast channel parameters (SF 11, BW 250 kHz, CR 4/5).

	  Requires a LoRa transceiver supported by the Zephyr LoRa driver
	  (e.g. SX1276, SX1262) and the nanopb module in the west workspace.

if MESHTASTIC

config MESHTASTIC_PHONEAPI
	bool

menuconfig MESHTASTIC_SETTINGS
	bool "Persist Meshtastic configuration with Zephyr settings"
	select SETTINGS
	help
	  Store Meshtastic owner, channel, config and module settings through
	  Zephyr's settings subsystem. The selected settings backend remains
	  controlled by the application or board configuration.

if MESHTASTIC_SETTINGS

config MESHTASTIC_SETTINGS_SAVE_DELAY_MS
	int "Meshtastic settings save delay (ms)"
	default 1000
	range 0 60000
	help
	  Delay used to coalesce runtime configuration changes before saving
	  the Meshtastic settings subtree.

endif # MESHTASTIC_SETTINGS

module = MESHTASTIC
module-str = meshtastic
source "subsys/logging/Kconfig.template.log_config"

rsource "Kconfig.core"
rsource "Kconfig.nodedb"
rsource "Kconfig.nodeinfo"
rsource "Kconfig.message"
rsource "Kconfig.ble"
rsource "Kconfig.serial"
rsource "Kconfig.shell"
rsource "Kconfig.gnss"
rsource "Kconfig.device_metrics"
rsource "Kconfig.airtime"
rsource "Kconfig.environment_metrics"
rsource "Kconfig.telemetry"
rsource "Kconfig.mqtt"

menu "LoRa transmit retry"

config MESHTASTIC_TX_BUSY_RETRIES
	int "Retries when CAD reports busy channel"
	range 0 32
	default 6
	help
	  Number of retransmission attempts when lora_send() returns -EBUSY
	  because CAD/LBT detected channel activity.

config MESHTASTIC_TX_BUSY_BACKOFF_MIN_MS
	int "Minimum backoff on busy channel (ms)"
	range 0 60000
	default 8
	help
	  Minimum randomized wait in milliseconds between retry attempts when
	  the channel is busy.

config MESHTASTIC_TX_BUSY_BACKOFF_MAX_MS
	int "Maximum backoff on busy channel (ms)"
	range 0 60000
	default 40
	help
	  Maximum randomized wait in milliseconds between retry attempts when
	  the channel is busy.
	  If this is less than the minimum, the minimum value is used.

endmenu

endif # MESHTASTIC
```

## src/Kconfig.airtime
```kconfig
# Copyright (c) 2026 The Zephyr Project Contributors
# SPDX-License-Identifier: GPL-3.0

config MESHTASTIC_AIRTIME
	bool "Meshtastic channel and TX airtime accounting"
	default y
	depends on MESHTASTIC_DEVICE_METRICS
	help
	  Track LoRa time-on-air for TX and RX and expose channel_utilization
	  and air_util_tx in DeviceMetrics telemetry, matching official firmware.
```

## src/Kconfig.ble
```kconfig
# Copyright (c) 2026 The Zephyr Project Contributors
# SPDX-License-Identifier: GPL-3.0

menuconfig MESHTASTIC_BLE
	bool "Meshtastic Bluetooth PhoneAPI service"
	depends on BT && BT_PERIPHERAL
	select MESHTASTIC_PHONEAPI
	help
	  Expose the Meshtastic Bluetooth GATT service with toRadio,
	  fromRadio, fromNum, and logRadio characteristics.

if MESHTASTIC_BLE

config MESHTASTIC_BLE_PAIRING
	bool "Support phone pairing and bonding"
	default y
	select BT_SMP
	select BT_SMP_APP_PAIRING_ACCEPT
	help
	  Enable Bluetooth SMP so mobile apps that initiate bonding can pair
	  with the Meshtastic BLE service instead of failing with pairing not
	  supported.

config MESHTASTIC_BLE_FIXED_PASSKEY
	bool "Use a fixed passkey for Meshtastic app pairing"
	default n
	depends on MESHTASTIC_BLE_PAIRING
	select BT_APP_PASSKEY
	select BT_SMP_ENFORCE_MITM
	help
	  When enabled, use MITM-protected Secure Connections pairing with a
	  six-digit passkey (default 123456) and report FIXED_PIN to phone
	  clients. When disabled (default), pairing uses Just Works with no
	  passkey and phone clients receive NO_PIN in the Bluetooth config.

config MESHTASTIC_BLE_PASSKEY
	int "Bluetooth pairing passkey"
	default 123456
	range 0 999999
	depends on MESHTASTIC_BLE_FIXED_PASSKEY
	help
	  Passkey entered in the Meshtastic mobile app during pairing. Matches
	  the official firmware fixed_pin default.

config MESHTASTIC_BLE_ADV
	bool "Start Meshtastic BLE advertising from meshtastic_init"
	default y
	help
	  Start connectable advertising for the Meshtastic service after the
	  Bluetooth stack is enabled.

config MESHTASTIC_BLE_DEVICE_NAME
	string "Bluetooth advertising name"
	default "Zephyr Meshtastic"
	help
	  Complete local name included in Meshtastic BLE advertisements.

config MESHTASTIC_BLE_FROMRADIO_QUEUE_SIZE
	int "FromRadio queue depth"
	default 8
	range 8 64
	help
	  Number of encoded FromRadio frames retained for Bluetooth clients.

config MESHTASTIC_BLE_WORK_STACK_SIZE
	int "Bluetooth PhoneAPI work thread stack size"
	default 6144
	help
	  Stack size for deferred ToRadio/FromRadio protobuf handling. Config
	  sync builds large FromRadio messages and must not run on the small
	  Bluetooth host workqueue stack.

config MESHTASTIC_BLE_WORK_PRIORITY
	int "Bluetooth PhoneAPI work thread priority"
	default 8
	help
	  Priority for deferred ToRadio command handling.

endif # MESHTASTIC_BLE
```

## src/Kconfig.core
```kconfig
# Copyright (c) 2026 The Zephyr Project Contributors
# SPDX-License-Identifier: GPL-3.0

menu "Meshtastic core"

config MESHTASTIC_THREAD_STACK_SIZE
	int "Processing thread stack size (bytes)"
	default 8192 if MESHTASTIC_BLE
	default 6144 if MESHTASTIC_GNSS || MESHTASTIC_DEVICE_METRICS || \
		MESHTASTIC_ENVIRONMENT_METRICS || MESHTASTIC_NODEINFO
	default 4096
	help
	  Stack size for the Meshtastic packet-processing thread.  Must
	  accommodate nanopb decoding, PSA crypto and the relay/auto-reply
	  transmit path.  Increase if stack overflows are observed.

config MESHTASTIC_THREAD_PRIORITY
	int "Processing thread priority"
	default 7
	help
	  Cooperative (negative) or preemptive (non-negative) priority of the
	  Meshtastic packet-processing thread.

config MESHTASTIC_RX_QUEUE_DEPTH
	int "Receive hand-off queue depth (frames)"
	default 4
	range 2 16
	help
	  Number of raw LoRa frames buffered between the driver receive
	  callback and the processing thread.  Each slot consumes about
	  260 bytes of RAM.  Increase if rx_dropped climbs under bursty
	  traffic (the processing thread fell behind incoming packets).

config MESHTASTIC_RX_REARM_RETRY_MS
	int "Receive re-arm retry interval (ms)"
	default 1000
	help
	  If re-arming continuous receive after a transmit fails, the radio
	  is left deaf.  The processing thread retries the re-arm at this
	  interval until it succeeds.

config MESHTASTIC_OUTBOUND_QUEUE_DEPTH
	int "Outbound LoRa transmit queue depth (frames)"
	default 8
	range 2 32
	help
	  Number of wire frames waiting for the outbound transmit worker.
	  All LoRa TX (application packets, relay, periodic telemetry) is
	  serialized through this queue.

config MESHTASTIC_OUTBOUND_STACK_SIZE
	int "Outbound transmit worker stack size (bytes)"
	default 2048
	help
	  Stack for the thread that performs serialized LoRa transmits.

config MESHTASTIC_PACKET_HEXDUMP
	bool "Hex dump LoRa wire packets at DBG log level"
	default MESHTASTIC_LOG_LEVEL_DBG
	help
	  When enabled and the meshtastic log level is DBG, log a hex dump of
	  each Meshtastic wire packet (16-byte header plus encrypted payload)
	  on transmit and receive.

config MESHTASTIC_DEFAULT_HOP_LIMIT
	int "Default hop limit for outgoing packets"
	default 3
	range 1 7
	help
	  Number of times an outgoing packet may be relayed by intermediate
	  nodes.  3 is the Meshtastic firmware default; higher values increase
	  range at the cost of additional channel utilisation.

config MESHTASTIC_TX_POWER
	int "Default TX power (dBm)"
	default 17
	help
	  Default LoRa transmit power used when meshtastic_config.tx_power is
	  zero.  Most LoRa modules support 2–20 dBm; consult your hardware
	  datasheet for the allowed range.

config MESHTASTIC_DUP_CACHE_SIZE
	int "Duplicate-packet cache size (entries)"
	default 16
	range 4 64
	help
	  Number of (src, packet_id) pairs retained for duplicate suppression.
	  Each entry consumes 8 bytes of RAM.  Increase if duplicate packets
	  are observed in dense mesh deployments.

config MESHTASTIC_NODE_LONG_NAME
	string "Default node long name"
	default "Zephyr Meshtastic"
	help
	  Human-readable node name used when meshtastic_config.long_name is
	  NULL. This is reported through local APIs such as Bluetooth PhoneAPI.

config MESHTASTIC_NODE_SHORT_NAME
	string "Default node short name"
	default "ZEPH"
	help
	  Short node name used when meshtastic_config.short_name is NULL.

choice MESHTASTIC_NODE_ID_SOURCE
	prompt "Node ID source"
	default MESHTASTIC_NODE_ID_HWINFO if HWINFO_HAS_DRIVER
	default MESHTASTIC_NODE_ID_CUSTOM
	help
	  How the local 32-bit Meshtastic node ID is determined at init time.

config MESHTASTIC_NODE_ID_HWINFO
	bool "HWINFO device ID"
	depends on HWINFO_HAS_DRIVER
	help
	  Derive the node ID from the last four bytes of the value returned by
	  hwinfo_get_device_id().  Requires CONFIG_HWINFO.

#config MESHTASTIC_NODE_ID_BT_MAC
#	bool "Bluetooth identity address"
#	depends on BT
#	help
#	  Derive the node ID from the last four bytes of the default Bluetooth
#	  identity address (bt_id_get).
#
#config MESHTASTIC_NODE_ID_WIFI_MAC
#	bool "Wi-Fi link-layer address"
#	depends on NET_IF
#	help
#	  Derive the node ID from the last four bytes of the default network
#	  interface link-layer address.

config MESHTASTIC_NODE_ID_CUSTOM
	bool "Custom fixed value"
	help
	  Use meshtastic_config.node_id when non-zero, otherwise
	  CONFIG_MESHTASTIC_NODE_ID_DEFAULT.

endchoice

config MESHTASTIC_NODE_ID_DEFAULT
	hex "Default node ID (custom source)"
	depends on MESHTASTIC_NODE_ID_CUSTOM
	default 0xDEADBEEF
	help
	  Node ID used when MESHTASTIC_NODE_ID_CUSTOM is selected and
	  meshtastic_config.node_id is zero.

endmenu
```

## src/Kconfig.device_metrics
```kconfig
# Copyright (c) 2026 The Zephyr Project Contributors
# SPDX-License-Identifier: GPL-3.0

menuconfig MESHTASTIC_DEVICE_METRICS
	bool "Meshtastic device metrics telemetry"
	default y
	help
	  Enable Telemetry.device_metrics encoding and send helpers. Uptime is
	  always included.

if MESHTASTIC_DEVICE_METRICS

config MESHTASTIC_DEVICE_METRICS_AUTO_SEND
	bool "Automatically send device metrics"
	default y
	help
	  Send device metrics periodically after meshtastic_init().

config MESHTASTIC_DEVICE_METRICS_INTERVAL_SEC
	int "Device metrics send interval in seconds"
	default 900
	range 30 86400
	help
	  Interval between automatic device metrics Telemetry packets.

config MESHTASTIC_FUEL_GAUGE
	bool "Include battery metrics from fuel_gauge0"
	depends on FUEL_GAUGE
	help
	  If devicetree alias fuel_gauge0 exists and is ready, include state
	  of charge and voltage in DeviceMetrics when the driver supports
	  those properties.

endif # MESHTASTIC_DEVICE_METRICS
```

## src/Kconfig.environment_metrics
```kconfig
# Copyright (c) 2026 The Zephyr Project Contributors
# SPDX-License-Identifier: GPL-3.0

menuconfig MESHTASTIC_ENVIRONMENT_METRICS
	bool "Meshtastic environment metrics telemetry"
	depends on SENSOR
	select REQUIRES_FLOAT_PRINTF
	help
	  Read temperature/humidity/pressure/gas/light sensors via the
	  ambient_temp0, humidity0, pressure_sensor, gas_sensor and
	  light_sensor devicetree aliases and broadcast Meshtastic
	  EnvironmentMetrics Telemetry. Only quantities whose alias exists
	  and is "okay" are compiled in.

if MESHTASTIC_ENVIRONMENT_METRICS

config MESHTASTIC_ENVIRONMENT_METRICS_AUTO_SEND
	bool "Automatically send environment metrics"
	default y
	help
	  Send environment metrics periodically after meshtastic_init().

config MESHTASTIC_ENVIRONMENT_METRICS_INTERVAL_SEC
	int "Environment metrics send interval in seconds"
	default 900
	range 30 86400
	help
	  Interval between automatic environment metrics Telemetry packets.

endif # MESHTASTIC_ENVIRONMENT_METRICS
```

## src/Kconfig.gnss
```kconfig
# Copyright (c) 2026 The Zephyr Project Contributors
# SPDX-License-Identifier: GPL-3.0

menuconfig MESHTASTIC_GNSS
	bool "Meshtastic GNSS position service"
	depends on GNSS
	help
	  Subscribe to Zephyr GNSS data and send Meshtastic Position payloads.

if MESHTASTIC_GNSS

config MESHTASTIC_GNSS_AUTO_SEND
	bool "Automatically send GNSS fixes"
	default y
	help
	  Send a Position payload whenever a valid GNSS fix is published and
	  the configured interval has elapsed.

config MESHTASTIC_GNSS_SEND_INTERVAL_SEC
	int "GNSS position send interval in seconds"
	default 300
	range 5 86400
	help
	  Minimum interval between successful automatic Position packets.

config MESHTASTIC_GNSS_RETRY_INTERVAL_SEC
	int "Minimum seconds between failed position send attempts"
	default 60
	range 5 3600
	help
	  After a failed automatic position transmission, wait at least this
	  long before trying again. Prevents hammering the radio when the GNSS
	  driver publishes fixes frequently.

config MESHTASTIC_GNSS_REPLY_SUPPRESS_SEC
	int "Minimum seconds between Position want_response replies"
	default 180
	range 0 86400
	help
	  Rate-limit responses to incoming Position requests with want_response
	  set, matching stock PositionModule behavior.

if MESHTASTIC_GNSS_AUTO_SEND

config MESHTASTIC_GNSS_SEND_WORK_STACK_SIZE
	int "GNSS position send workqueue stack size"
	default 2048
	help
	  Stack for the dedicated workqueue that sends Position packets
	  (nanopb encoding and PSA AES-CTR on a full payload buffer).

config MESHTASTIC_GNSS_SEND_WORK_PRIORITY
	int "GNSS position send workqueue priority"
	default 8
	help
	  Priority for deferred GNSS position transmissions.

endif # MESHTASTIC_GNSS_AUTO_SEND

endif # MESHTASTIC_GNSS
```

## src/Kconfig.message
```kconfig
# Copyright (c) 2026 The Zephyr Project Contributors
# SPDX-License-Identifier: GPL-3.0

config MESHTASTIC_MESSAGE
	bool "Meshtastic text message handling"
	default y
	help
	  Register a port handler for incoming TEXT_MESSAGE_APP (port 1)
	  packets: log received text and notify applications via
	  @c MESHTASTIC_EVENT_TEXT_MESSAGE.

	  Duplicate suppression is handled by the core stack
	  (@kconfig{CONFIG_MESHTASTIC_DUP_CACHE_SIZE}) before packets reach
	  any module.
```
